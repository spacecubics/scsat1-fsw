## lib/csp/Kconfig
```kconfig
# Copyright (c) 2024 Space Cubics, LLC.
# SPDX-License-Identifier: Apache-2.0

menuconfig SC_LIB_CSP
	bool "Space Cubics CSP libraries"
	depends on LIBCSP
	default y
	help
	  Enable Space Cubics CSP libraries.

if SC_LIB_CSP

config SC_LIB_CSP_FILE_NAME_MAX_LEN
	int "File name max length for csp commands"
	default 64
	help
	  File name max length for csp commands

config SC_LIB_CSP_CONN_TIMEOUT_MSEC
	int "Timeout for CSP connect (msec)"
	default 500
	help
	  Timeout for CSP connect (msec).

config SC_LIB_CSP_READ_TIMEOUT_MSEC
	int "Timeout for CSP read (msec)"
	default 100
	help
	  Timeout for CSP read (msec).

config SC_LIB_CSP_FILE_THREAD_PRIORITY
	int "File operation thread priority"
	default 3
	help
	  File operation thread priority

config SC_LIB_CSP_FILE_THREAD_STACK_SIZE
	int "File operation thread stack size"
	default 4096
	help
	  File operation thread stack size.

config SC_LIB_CSP_MAX_FILE_WORK
	int "MAX number of file operation work"
	default 10
	help
	  MAX number of file operation work.

config SC_LIB_CSP_CRC_CHUNK_SIZE
	int "Chunk size for CRC32 calculation"
	default 256
	help
	  Chunk size for CRC 32 calculation.

config SC_LIB_CSP_CRC_CALC_SLEEP_MSEC
	int "Sleep time for CRC32 calculation (msec)"
	default 20
	help
	  Sleep time for CRC32 calculation (msec).

config SC_LIB_CSP_UPLOAD_MAX_SESSION
	int "Maximum session number for upload"
	default ZVFS_OPEN_MAX
	help
	  Maximum session number for upload.
	  It must be the same as or smaller than CONFIG_ZVFS_OPEN_MAX.

module = SC_LIB_CSP
module-str = Space Cubics CSP libraries
source "subsys/logging/Kconfig.template.log_config"

endif
```

## lib/flash/Kconfig
```kconfig
# Copyright (c) 2024 Space Cubics, LLC.
# SPDX-License-Identifier: Apache-2.0

menuconfig SC_LIB_FLASH
	bool "Space Cubics Flash Memory libraries"
	default y
	help
	  Enable Space Cubics Flash Memory libraries.

if SC_LIB_FLASH

config SC_LIB_FLASH_CRC_CHUNK_SIZE
	int "Chunk size for calculate CRC32"
	default 256
	help
	  Chunk size for calculate CRC32.

config SC_LIB_FLASH_CRC_SLEEP_MSEC
	int "Sleep time for calculate CRC32 (msec)"
	default 20
	help
	  Sleep time for calculate CRC32 (msec).

config SC_LIB_FLASH_DATA
	bool "Enable Data Store Flash Memory"
	default y
	depends on FILE_SYSTEM_LITTLEFS
	help
	  Enable Data Store Flash Memory

if SC_LIB_FLASH_DATA

config SC_LIB_FLASH_DATA_STORE_MNT_POINT
	string "Mount point name for Data Store Flash memory"
	default "/storage"
	help
	  Mount point name for Data Store Flash memory

endif #SC_LIB_FLASH_DATA

module = SC_LIB_FLASH
module-str = Space Cubics Flash Memory libraries
source "subsys/logging/Kconfig.template.log_config"

endif #SC_LIB_FLASH
```

## lib/fram/Kconfig
```kconfig
# Copyright (c) 2024 Space Cubics, LLC.
# SPDX-License-Identifier: Apache-2.0

menuconfig SC_LIB_FRAM
	bool "Space Cubics F-RAM libraries"
	default y
	help
	  Enable Space Cubics F-RAM libraries.

if SC_LIB_FRAM

module = SC_LIB_FRAM
module-str = Space Cubics F-RAM libraries
source "subsys/logging/Kconfig.template.log_config"

endif
```

## lib/gnss/Kconfig
```kconfig
# Copyright (c) 2024 Space Cubics, LLC.
# SPDX-License-Identifier: Apache-2.0

menuconfig SC_LIB_GNSS
	bool "Space Cubics GNSS libraries"
	default y
	depends on BOARD_SCSAT1_ADCS
	help
	  Enable Space Cubics GNSS libraries.

if SC_LIB_GNSS

module = SC_LIB_GNSS
module-str = Space Cubics GNSS libraries
source "subsys/logging/Kconfig.template.log_config"

endif
```

## lib/imu/Kconfig
```kconfig
# Copyright (c) 2024 Space Cubics, LLC.
# SPDX-License-Identifier: Apache-2.0

menuconfig SC_LIB_IMU
	bool "Space Cubics IMU libraries"
	default y
	depends on BOARD_SCSAT1_ADCS
	help
	  Enable Space Cubics IMU libraries.

if SC_LIB_IMU

module = SC_LIB_IMU
module-str = Space Cubics IMU libraries
source "subsys/logging/Kconfig.template.log_config"

endif
```

## lib/mgnm/Kconfig
```kconfig
# Copyright (c) 2024 Space Cubics, LLC.
# SPDX-License-Identifier: Apache-2.0

menuconfig SC_LIB_MGNM
	bool "Space Cubics Magnetometer libraries"
	default y
	depends on DT_HAS_SC_I2C_ENABLED
	depends on BOARD_SCSAT1_MAIN
	help
	  Enable Space Cubics Magnetometer libraries.

if SC_LIB_MGNM

module = SC_LIB_MGNM
module-str = Space Cubics Magnetometer libraries
source "subsys/logging/Kconfig.template.log_config"

endif
```

## lib/mtq/Kconfig
```kconfig
# Copyright (c) 2024 Space Cubics, LLC.
# SPDX-License-Identifier: Apache-2.0

menuconfig SC_LIB_MTQ
	bool "Space Cubics Magnetic Torquer libraries"
	default y
	depends on DT_HAS_SC_I2C_ENABLED
	depends on BOARD_SCSAT1_MAIN
	help
	  Enable Space Cubics Magnetic Torquer libraries.

if SC_LIB_MTQ

module = SC_LIB_MTQ
module-str = Space Cubics Magnetic Torquer libraries
source "subsys/logging/Kconfig.template.log_config"

endif
```

## lib/rw/Kconfig
```kconfig
# Copyright (c) 2024 Space Cubics, LLC.
# SPDX-License-Identifier: Apache-2.0

menuconfig SC_LIB_RW
	bool "Space Cubics Reaction Wheel libraries"
	default y
	depends on BOARD_SCSAT1_ADCS
	help
	  Enable Space Cubics Reaction Wheel libraries.

if SC_LIB_RW

module = SC_LIB_RW
module-str = Space Cubics Reaction Wheel libraries
source "subsys/logging/Kconfig.template.log_config"

endif
```

## lib/sunsens/Kconfig
```kconfig
# Copyright (c) 2024 Space Cubics, LLC.
# SPDX-License-Identifier: Apache-2.0

menuconfig SC_LIB_SUNSENS
	bool "Space Cubics Sun Sensor libraries"
	default y
	depends on DT_HAS_SC_I2C_ENABLED
	depends on BOARD_SCSAT1_MAIN
	help
	  Enable Space Cubics Sun Sensor libraries.

if SC_LIB_SUNSENS

module = SC_LIB_SUNSENS
module-str = Space Cubics Sun Sensor libraries
source "subsys/logging/Kconfig.template.log_config"

endif
```

## west.yml
```yaml
manifest:

  projects:
    - name: zephyr
      url: https://github.com/zephyrproject-rtos/zephyr
      revision: 30af4b26968c640d605f6e7853cff4e8daebe4f8
      path: zephyr
      west-commands: scripts/west-commands.yml
      import:
        name-allowlist:
          - cmsis
          - picolibc

    - name: libcsp
      url: https://github.com/libcsp/libcsp.git
      revision: 1653d5b340cdf97ceb97dbf84b2dcbbfe8623e8c
      path: modules/lib/libcsp

    - name: littlefs
      url: https://github.com/zephyrproject-rtos/littlefs.git
      revision: 009bcff0ed4853a53df8256039fa815bda6854dd
      path: modules/fs/littlefs
      groups:
        - fs
```

## zephyr/Kconfig
```kconfig
# Copyright (c) 2023 Space Cubics, LLC.
# SPDX-License-Identifier: Apache-2.0

rsource "drivers/can/Kconfig"
rsource "drivers/i2c/Kconfig"
```

## zephyr/drivers/can/Kconfig
```kconfig
# Copyright (c) 2023 Space Cubics, LLC.
# SPDX-License-Identifier: Apache-2.0

if CAN

rsource "Kconfig.sccan"

endif
```

## zephyr/drivers/i2c/Kconfig
```kconfig
# Copyright (c) 2023 Space Cubics, LLC.
# SPDX-License-Identifier: Apache-2.0

if I2C

rsource "Kconfig.sc"

endif
```

## zephyr/drivers/pwm/Kconfig
```kconfig
# Copyright (c) 2023 Space Cubics, LLC.
# SPDX-License-Identifier: Apache-2.0

if PWM

rsource "Kconfig.sc"

endif
```

## zephyr/drivers/spi/Kconfig
```kconfig
# Copyright (c) 2023 Space Cubics, LLC.
# SPDX-License-Identifier: Apache-2.0

if SPI

rsource "Kconfig.sc"

endif
```

## zephyr/dts/bindings/can/sc,can.yaml
```yaml
description: Space Cubics CAN controller

compatible: "sc,can"

include: [can-controller.yaml]

properties:
  reg:
    required: true

  interrupts:
    required: true

  sample-point:
    required: true

  clock-frequency:
    type: int
    description: |
      CAN Clock frequency on the FPGA. Basicaly the CAN clock is
      always 24 MHz, irrespective of the frequency of the system
      clock.
    required: true
```

## zephyr/dts/bindings/i2c/sc,i2c.yaml
```yaml
description: Space Cubics I2C Master controller

compatible: "sc,i2c"

include: [i2c-controller.yaml]

properties:
  reg:
    required: true

  interrupts:
    required: true
```

## zephyr/dts/bindings/pwm/sc,pwm.yaml
```yaml
description: Space Cubics PWM controller

compatible: "sc,pwm"

include: [base.yaml]

properties:
  reg:
    required: true

  max-out-channel:
    type: int
    description: |
      The maximum value for the output channel that can be
      configured on the FPGA.
    required: true
```

## zephyr/dts/bindings/qspi/sc,qspi.yaml
```yaml
# Copyright (c) 2023, Space Cubics, LLC.
# SPDX-License-Identifier: Apache-2.0

description: Space Cubics QSPI

compatible: "sc,qspi"

include: spi-controller.yaml

bus: spi

properties:
  reg:
    required: true

  interrupts:
    required: true

  data-capture-mode:
    type: boolean
    description: Whether to capture data while sending

  slave-num:
    type: int
    description: The number of slave device under the QSPI contoler
    required: true

  cpol:
    type: int
    description: Clock Polarity in SPI
    required: true

  cpha:
    type: int
    description: Clock Phase in SPI
    required: true

  spiclk_div:
    type: int
    description: Clock divider for the SPI clock relative to the system clock
    required: true
```
