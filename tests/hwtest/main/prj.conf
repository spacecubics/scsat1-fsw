## CMakeLists.txt
```
# SPDX-License-Identifier: Apache-2.0

cmake_minimum_required(VERSION 3.20.0)

set(BOARD scsat1_main)
set(BOARD_ROOT ${CMAKE_CURRENT_LIST_DIR}/../../../)

find_package(Zephyr REQUIRED HINTS $ENV{ZEPHYR_BASE})
project(scsat1-main)

target_sources(app PRIVATE src/main.c)
target_sources(app PRIVATE src/mgnm.c )
target_sources(app PRIVATE src/mgnm_test.c )
target_sources(app PRIVATE src/temp_test.c)
target_sources(app PRIVATE src/cv_test.c)
target_sources(app PRIVATE src/csp.c)
target_sources(app PRIVATE src/csp_test.c)
target_sources(app PRIVATE src/sunsens_test.c)
target_sources(app PRIVATE src/mtq.c)
target_sources(app PRIVATE src/mtq_test.c)
target_sources(app PRIVATE src/dstrx3_test.c)
target_sources(app PRIVATE src/scbus.c)
target_sources(app PRIVATE src/main_init.c)
target_sources(app PRIVATE src/loop_test.c)
target_sources(app PRIVATE src/syshk_test.c)
target_sources(app PRIVATE src/syshk.c)
```

## Kconfig
```
mainmenu "SC-Sat1 Main Board"

menu "Application"

config SCSAT1_MAIN_AUTO_RUN_HWTEST
	bool "Enable auto run for HW test"
	default n
	help
	  Enable auto run for HW test.

config SCSAT1_MAIN_CAP_INTERVAL_SEC
	int "Interval (seconds) of capture frame command"
	default 60
	help
	  Interval (seconds) of capture frame command

module = SCSAT1_MAIN
module-str = SC-Sat1 Main Board
source "subsys/logging/Kconfig.template.log_config"

endmenu

menu "Zephyr"
source "Kconfig.zephyr"
endmenu
```

## prj.conf
```kconfig
CONFIG_LIBCSP=y
CONFIG_PICOLIBC=y
CONFIG_CAN=y
CONFIG_I2C=y
CONFIG_SPI=y
CONFIG_SPI_EXTENDED_MODES=y
CONFIG_PWM=y
CONFIG_LOG=y
CONFIG_EVENTS=y
CONFIG_SHELL=y
CONFIG_SHELL_PROMPT_UART="main:~$ "
CONFIG_LOG_BUFFER_SIZE=4096
CONFIG_MAIN_STACK_SIZE=4096
CONFIG_PICOLIBC_IO_FLOAT=y
# For CSP
CONFIG_LIBCSP=y
CONFIG_CSP_USE_RTABLE=y
CONFIG_EVENTS=y
CONFIG_HEAP_MEM_POOL_SIZE=4096
CONFIG_CSP_CAN_RX_THREAD_NUM=2
# For NOR flash
CONFIG_FLASH=y
CONFIG_SPI_NOR=y
CONFIG_FLASH_MAP=y
CONFIG_FLASH_MAP_LABELS=y
# For LittleFS
CONFIG_FILE_SYSTEM=y
CONFIG_FILE_SYSTEM_LITTLEFS=y
```

## src/main.c
```c
/*
 * Copyright (c) 2023 Space Cubics, LLC.
 *
 * SPDX-License-Identifier: Apache-2.0
 */

#include <stdlib.h>
#include <zephyr/kernel.h>
#include <zephyr/shell/shell_uart.h>
#include "common.h"
#include "csp.h"
#include "wdog.h"
#include "temp_test.h"
#include "cv_test.h"
#include "mgnm_test.h"
#include "csp_test.h"
#include "sunsens_test.h"
#include "mtq_test.h"
#include "dstrx3_test.h"
#include "scbus.h"
#include "main_init.h"
#include "loop_test.h"
#include "syshk_test.h"
#include "data_nor.h"
#include "sc_fpgasys.h"
#include "sc_fpgamon.h"
#include "version.h"

#include <zephyr/logging/log.h>
LOG_MODULE_REGISTER(main, CONFIG_SCSAT1_MAIN_LOG_LEVEL);

#define CMD_HANDLER_PRIO (0U)
#define CMD_EXEC_EVENT   (1U)
#define BOOT_COUNT_FILE  CONFIG_SC_LIB_FLASH_DATA_STORE_MNT_POINT "/boot.count"

char last_cmd[32];

K_THREAD_STACK_DEFINE(cmd_thread_stack, 2048);
static struct k_thread cmd_thread;
static struct k_event exec_event;
extern struct k_event loop_event;

static void sc_main_print_fpga_ids(void)
{
	LOG_INF("* FSW Version       : %s", MAIN_HWTEST_VERSION);
	LOG_INF("* Boot CFG Memory   : %d", sc_get_boot_cfgmem());
	LOG_INF("* FPGA Boot Status  : 0x%x", sc_get_bootsts());
	LOG_INF("* IP Version        : %08x", sc_get_fpga_ip_ver());
	LOG_INF("* Build Information : %08x", sc_get_fpga_build_hash());
	LOG_INF("* Device DNA 1      : %08x", sc_get_fpga_dna_1());
	LOG_INF("* Device DNA 2      : %08x",sc_get_fpga_dna_2());
}

static void cmd_handler(void *p1, void *p2, void *p3)
{
	int ret = 0;
	uint32_t err_cnt = 0;
	char *cmd = (char *)p1;
	char *arg1 = (char *)p2;
	char *arg2 = (char *)p3;
	struct main_temp_test_result temp_ret;
	struct main_cv_test_result cv_ret;
	struct csp_test_result csp_ret;
	struct sunsens_test_ret sunsens_ret;
	struct mgnm_test_ret mgnm_ret;
	struct dstrx3_test_ret dstrx3_ret;

	k_event_set(&exec_event, CMD_EXEC_EVENT);

	ARG_UNUSED(p3);

	if (strcmp(cmd, "info") == 0) {
		sc_main_print_fpga_ids();
	} else if (strcmp(cmd, "init") == 0) {
		ret = main_init((enum hwtest_mode)atoi(arg1), &err_cnt);
	} else if (strcmp(cmd, "off") == 0) {
		ret = main_off(&err_cnt);
	} else if (strcmp(cmd, "temp") == 0) {
		ret = temp_test(&temp_ret, &err_cnt, LOG_ENABLE);
	} else if (strcmp(cmd, "cv") == 0) {
		ret = cv_test(&cv_ret, &err_cnt, LOG_ENABLE);
	} else if (strcmp(cmd, "mgnm") == 0) {
		ret = mgnm_test(&mgnm_ret, &err_cnt, LOG_ENABLE);
	} else if (strcmp(cmd, "csp") == 0) {
		ret = csp_test(&csp_ret, &err_cnt, LOG_ENABLE);
	} else if (strcmp(cmd, "sun") == 0) {
		ret = sunsens_test(&sunsens_ret, &err_cnt, LOG_ENABLE);
	} else if (strcmp(cmd, "mtq") == 0) {
		ret = mtq_test(&err_cnt, atoi(arg1));
	} else if (strcmp(cmd, "dstrx3") == 0) {
		ret = dstrx3_test(&dstrx3_ret, &err_cnt, LOG_ENABLE);
	} else if (strcmp(cmd, "dstrx3_down") == 0) {
		dstrx3_downlink_loop_test(atoi(arg1), atoi(arg2));
	} else if (strcmp(cmd, "dstrx3_up") == 0) {
		dstrx3_uplink_test(arg1);
	} else if (strcmp(cmd, "loop") == 0) {
		k_event_set(&loop_event, LOOP_START_EVENT);
		ret = loop_test(atoi(arg1), &err_cnt);
		k_event_clear(&loop_event, LOOP_STOP_EVENT);
	} else if (strcmp(cmd, "syshk") == 0) {
		k_event_set(&loop_event, LOOP_START_EVENT);
		ret = syshk_test(atoi(arg1), &err_cnt);
		k_event_clear(&loop_event, LOOP_STOP_EVENT);
	} else {
		goto end;
	}

	if (ret < 0) {
		LOG_ERR("%s test Failed. eror count: %d", cmd, err_cnt);
	} else {
		LOG_INF("%s test successed.", cmd);
	}

end:
	k_event_clear(&exec_event, CMD_EXEC_EVENT);

	return;
}

static int start_cmd_thread(const struct shell *sh, size_t argc, char **argv)
{
	int ret = 0;
	k_tid_t cmd_tid;

	strncpy(last_cmd, sh->ctx->temp_buff, MIN(sh->ctx->cmd_tmp_buff_len, sizeof(last_cmd) - 1));

	if (argc < 1) {
		shell_error(sh, "Invalid argument");
		ret = -EINVAL;
		goto end;
	}

	if (k_event_wait(&exec_event, CMD_EXEC_EVENT, false, K_NO_WAIT) != 0) {
		shell_error(sh, "Now another command is executing");
		ret = -EBUSY;
		goto end;
	}

	cmd_tid = k_thread_create(&cmd_thread, cmd_thread_stack,
				  K_THREAD_STACK_SIZEOF(cmd_thread_stack),
				  (k_thread_entry_t)cmd_handler, argv[0], argv[1], argv[2],
				  CMD_HANDLER_PRIO, 0, K_NO_WAIT);
	if (!cmd_tid) {
		shell_error(sh, "Failed to create command thread");
		ret = ENOSPC;
	}
end:
	return ret;
}

int main(void)
{
	int ret;

	printk("This is for HW test program for %s\n", CONFIG_BOARD);

	datafs_init();

	start_kick_wdt_thread();

	sc_main_print_fpga_ids();

	k_event_init(&exec_event);

	update_boot_count(BOOT_COUNT_FILE);

	ret = csp_enable();
	if (ret < 0) {
		LOG_ERR("Failed to enable the CSP. (%d)", ret);
	} else {
		LOG_INF("Enable the CSP");
	}

	if (IS_ENABLED(CONFIG_SCSAT1_MAIN_AUTO_RUN_HWTEST)) {
		shell_execute_cmd(shell_backend_uart_get_ptr(), "hwtest init 3");

		k_sleep(K_SECONDS(60));

		shell_execute_cmd(shell_backend_uart_get_ptr(), "hwtest syshk -1");
	}

	return 0;
}

static int stop_cmd(const struct shell *sh, size_t argc, char **argv)
{
	strncpy(last_cmd, sh->ctx->temp_buff, MIN(sh->ctx->cmd_tmp_buff_len, sizeof(last_cmd) - 1));
	k_event_set(&loop_event, LOOP_STOP_EVENT);
	return 0;
}

SHELL_STATIC_SUBCMD_SET_CREATE(
	sub_hwtest, SHELL_CMD(info, NULL, "MAIN Board Information", start_cmd_thread),
	SHELL_CMD(init, NULL, "MAIN Board Initialization", start_cmd_thread),
	SHELL_CMD(off, NULL, "Turn off the each power and CAN", start_cmd_thread),
	SHELL_CMD(temp, NULL, "Temperature test command", start_cmd_thread),
	SHELL_CMD(cv, NULL, "Current/Voltage test command", start_cmd_thread),
	SHELL_CMD(mgnm, NULL, "Magnet Meteor test command", start_cmd_thread),
	SHELL_CMD(mtq, NULL, "Magnetorquer test command", start_cmd_thread),
	SHELL_CMD(csp, NULL, "CSP test command", start_cmd_thread),
	SHELL_CMD(sun, NULL, "Sun Sensor test command", start_cmd_thread),
	SHELL_CMD(dstrx3, NULL, "DSTRX-3 test command", start_cmd_thread),
	SHELL_CMD(dstrx3_down, NULL, "DSTRX-3 Downlink loop test command", start_cmd_thread),
	SHELL_CMD(dstrx3_up, NULL, "DSTRX-3 Uplink test command", start_cmd_thread),
	SHELL_CMD(loop, NULL, "Loop test command", start_cmd_thread),
	SHELL_CMD(syshk, NULL, "System HK test command", start_cmd_thread), SHELL_SUBCMD_SET_END);
SHELL_CMD_REGISTER(hwtest, &sub_hwtest, "SC-Sat1 HW test commands", NULL);
SHELL_CMD_REGISTER(stop, NULL, "SC-Sat1 HW test stop", stop_cmd);
```

## src/common.h
```c
/*
 * Copyright (c) 2024 Space Cubics, LLC.
 *
 * SPDX-License-Identifier: Apache-2.0
 */

#pragma once

#include <zephyr/logging/log.h>

#define LOOP_START_EVENT (0U)
#define LOOP_STOP_EVENT  (1U)
#define LOG_ENABLE       (true)
#define LOG_DISABLE      (false)

enum hwtest_mode {
	MAIN_ONLY_WITHOUT_DSTRX = 0,
	MAIN_ONLY,
	MAIN_ADCS_ONLY,
	FULL,
	TEST_MODE_NUM,
};

#define HWTEST_LOG_INF(log, format, ...)                                                           \
	if (log) {                                                                                 \
		LOG_INF(format, ##__VA_ARGS__);                                                    \
	}
#define HWTEST_LOG_DBG(log, format, ...)                                                           \
	if (log) {                                                                                 \
		LOG_DBG(format, ##__VA_ARGS__);                                                    \
	}
#define HWTEST_LOG_ERR(log, format, ...)                                                           \
	if (log) {                                                                                 \
		LOG_ERR(format, ##__VA_ARGS__);                                                    \
	}
```

## src/csp.c
```c
/*
 * Copyright (c) 2023 Space Cubics, LLC.
 *
 * SPDX-License-Identifier: Apache-2.0
 */
#include <string.h>
#include <unistd.h>
#include <stdlib.h>
#include <csp/csp.h>
#include <csp/csp_id.h>
#include <csp/drivers/can_zephyr.h>
#include <zephyr/device.h>
#include <zephyr/shell/shell_uart.h>
#include "csp.h"

#include <zephyr/logging/log.h>
LOG_MODULE_REGISTER(csp, CONFIG_SCSAT1_MAIN_LOG_LEVEL);

#define ROUTER_STACK_SIZE 256
#define SERVER_STACK_SIZE 1024
#define ROUTER_PRIO       0
#define SERVER_PRIO       0

static csp_iface_t *can_iface1 = NULL;
static csp_iface_t *can_iface2 = NULL;

void server();

static void *router_task(void *param)
{

	/* Here there be routing */
	while (true) {
		csp_route_work();
	}

	return NULL;
}

static void *server_task(void *p1, void *p2, void *p3)
{

	ARG_UNUSED(p1);
	ARG_UNUSED(p2);
	ARG_UNUSED(p3);

	server();

	return NULL;
}

K_THREAD_DEFINE(router_id, ROUTER_STACK_SIZE, router_task, NULL, NULL, NULL, ROUTER_PRIO, 0,
		K_TICKS_FOREVER);
K_THREAD_DEFINE(server_id, SERVER_STACK_SIZE, server_task, NULL, NULL, NULL, SERVER_PRIO, 0,
		K_TICKS_FOREVER);

static void router_start(void)
{
	k_thread_start(router_id);
}

static void server_start(void)
{
	k_thread_start(server_id);
}

extern csp_conf_t csp_conf;

void server(void)
{

	LOG_INF("Server task started");

	csp_socket_t sock = {0};

	csp_bind(&sock, CSP_ANY);

	csp_listen(&sock, 10);

	while (true) {

		csp_conn_t *conn;
		if ((conn = csp_accept(&sock, 10000)) == NULL) {
			continue;
		}

		csp_packet_t *packet;
		while ((packet = csp_read(conn, 50)) != NULL) {
			switch (csp_conn_dport(conn)) {
			case CSP_PORT_MAIN_SHELL_CMD:
				shell_execute_cmd(shell_backend_uart_get_ptr(), packet->data);
				csp_buffer_free(packet);
				break;
			default:
				csp_service_handler(packet);
				break;
			}
		}

		csp_close(conn);
	}

	return;
}

int csp_enable(void)
{
	int ret;
	const char *ifname1 = "CAN1";
	const char *ifname2 = "CAN2";
	const struct device *can1 = DEVICE_DT_GET(DT_NODELABEL(can0));
	const struct device *can2 = DEVICE_DT_GET(DT_NODELABEL(can1));
	uint32_t bitrate = 1000000;
	uint16_t filter_addr = CSP_ID_MAIN;
	uint16_t filter_mask = 0x1F;

	LOG_INF("Initialising CSP");

	csp_conf.version = 1;

	csp_init();

	ret = csp_can_open_and_add_interface(can1, ifname1, CSP_ID_MAIN, bitrate, filter_addr,
					     filter_mask, &can_iface1);
	if (ret != CSP_ERR_NONE) {
		LOG_ERR("failed to add CAN interface [%s], error: %d\n", ifname1, ret);
		goto end;
	}
	can_iface1->is_default = 1;

	ret = csp_can_open_and_add_interface(can2, ifname2, CSP_ID_MAIN, bitrate, filter_addr,
					     filter_mask, &can_iface2);
	if (ret != CSP_ERR_NONE) {
		LOG_ERR("failed to add CAN interface [%s], error: %d\n", ifname2, ret);
		goto end;
	}

	csp_rtable_set(CSP_ID_ADCS, csp_id_get_host_bits(), can_iface2, CSP_NO_VIA_ADDRESS);
	csp_rtable_set(CSP_ID_ZERO, csp_id_get_host_bits(), can_iface2, CSP_NO_VIA_ADDRESS);
	csp_rtable_set(CSP_ID_PICO, csp_id_get_host_bits(), can_iface2, CSP_NO_VIA_ADDRESS);

	LOG_INF("Connection table");
	csp_conn_print_table();

	LOG_INF("Interfaces");
	csp_iflist_print();

	csp_print("Route table\n");
	csp_rtable_print();

	router_start();

	server_start();
end:
	return ret;
}

void csp_disable(void)
{
	csp_can_stop(can_iface1);
	csp_can_stop(can_iface2);
}
```

## src/csp.h
```c
/*
 * Copyright (c) 2023 Space Cubics, LLC.
 *
 * SPDX-License-Identifier: Apache-2.0
 */

#pragma once

#define CSP_ID_MAIN (1U)
#define CSP_ID_ADCS (2U)
#define CSP_ID_EPS  (4U)
#define CSP_ID_SRS3 (5U)
#define CSP_ID_GND  (10U)
#define CSP_ID_ZERO (12U)
#define CSP_ID_PICO (14U)

#define CSP_PORT_MAIN_SHELL_CMD (10U)

int csp_enable(void);
void csp_disable(void);
```

## src/csp_test.c
```c
/*
 * Copyright (c) 2023 Space Cubics, LLC.
 *
 * SPDX-License-Identifier: Apache-2.0
 */
#include <string.h>
#include <unistd.h>
#include <stdlib.h>
#include <csp/csp.h>
#include <csp/drivers/can_zephyr.h>
#include <zephyr/device.h>
#include "common.h"
#include "csp.h"
#include "csp_test.h"

#include <zephyr/logging/log.h>
LOG_MODULE_REGISTER(csp_test, CONFIG_SCSAT1_MAIN_LOG_LEVEL);

#define CSP_TIMEOUT_MSEC   (100U)
#define CSP_GET_TEMP_ZERO  (11U)
#define CSP_INIT_DIR_ZERO  (12U)
#define CSP_CAP_FRAME_ZERO (13U)
#define CSP_GET_COUNT_ZERO (14U)
#define CSP_INVALID_PING   (0U)
#define CSP_INVALID_UPTIME (0U)
#define CSP_INVALID_TEMP   (0U)
#define CSP_INVALID_COUNT  (0U)
#define CSP_ADCS_SHELL_CMD (11U)

extern enum hwtest_mode test_mode;

static csp_packet_t *csp_send_cmd_to_zero(uint8_t port, bool reply, bool log)
{
	csp_packet_t *packet = NULL;

	csp_conn_t *conn =
		csp_connect(CSP_PRIO_NORM, CSP_ID_ZERO, port, CSP_TIMEOUT_MSEC, CSP_O_NONE);
	if (conn == NULL) {
		HWTEST_LOG_ERR(log, "CSP Connection failed");
		goto end;
	}

	packet = csp_buffer_get(0);
	if (packet == NULL) {
		HWTEST_LOG_ERR(log, "Failed to get CSP buffer");
		goto end;
	}
	packet->length = 0;

	csp_send(conn, packet);

	if (reply) {
		packet = csp_read(conn, CSP_TIMEOUT_MSEC);
		if (packet == NULL) {
			HWTEST_LOG_ERR(log, "Failed to CSP read");
			goto cleanup;
		}
	}

cleanup:
	csp_close(conn);

end:
	return packet;
}

static int csp_send_cmd_to_adcs(const char *cmd, bool log)
{
	int ret = 0;
	csp_packet_t *packet = NULL;

	csp_conn_t *conn = csp_connect(CSP_PRIO_NORM, CSP_ID_ADCS, CSP_ADCS_SHELL_CMD,
				       CSP_TIMEOUT_MSEC, CSP_O_NONE);
	if (conn == NULL) {
		HWTEST_LOG_ERR(log, "CSP Connection failed");
		ret = -1;
		goto end;
	}

	packet = csp_buffer_get(0);
	if (packet == NULL) {
		HWTEST_LOG_ERR(log, "Failed to get CSP buffer");
		ret = -1;
		goto cleanup;
	}
	packet->length = strlen(cmd) + 1;
	memcpy(packet->data, cmd, packet->length);

	csp_send(conn, packet);

cleanup:
	csp_close(conn);

end:
	return ret;
}

static int csp_get_zero_temp(float *temp, bool log)
{
	csp_packet_t *packet;
	int ret = 0;
	bool reply = true;

	packet = csp_send_cmd_to_zero(CSP_GET_TEMP_ZERO, reply, log);
	if (packet == NULL || packet->length != 2) {
		ret = -1;
		goto end;
	}

	*temp = (int8_t)packet->data[1] + (float)packet->data[0] * 0.0625f;
	csp_buffer_free(packet);
end:
	return ret;
}

static int csp_get_zero_frame_count(uint16_t *count, bool log)
{
	csp_packet_t *packet;
	int ret = 0;
	bool reply = true;

	packet = csp_send_cmd_to_zero(CSP_GET_COUNT_ZERO, reply, log);
	if (packet == NULL || packet->length != 2) {
		ret = -1;
		goto end;
	}

	*count = (packet->data[1] << 8) + packet->data[0];
	csp_buffer_free(packet);
end:
	return ret;
}

static bool csp_is_capture_period(void)
{
	uint32_t cur_uptime;
	static uint32_t last_cap_uptime = 0;

	cur_uptime = k_uptime_get_32() / MSEC_PER_SEC;

	if (last_cap_uptime == 0 ||
	    (cur_uptime - last_cap_uptime) >= CONFIG_SCSAT1_MAIN_CAP_INTERVAL_SEC) {
		last_cap_uptime = cur_uptime;
		return true;
	} else {
		return false;
	}
}

int csp_capture_frame(void)
{
	int ret = 0;
	csp_packet_t *packet;
	bool reply = false;
	bool log = true;

	packet = csp_send_cmd_to_zero(CSP_INIT_DIR_ZERO, reply, log);
	if (packet == NULL) {
		ret = -1;
	}

	return ret;
}

static int csp_capture_frame_zero(void)
{
	int ret = 0;
	csp_packet_t *packet;
	bool reply = false;
	bool log = true;

	packet = csp_send_cmd_to_zero(CSP_CAP_FRAME_ZERO, reply, log);
	if (packet == NULL) {
		ret = -1;
	}

	return ret;
}

int csp_test_init(void)
{
	int ret = 0;
	csp_packet_t *packet;
	bool reply = false;
	bool log = true;

	LOG_INF("===[Init photo directory on Zero]===");
	packet = csp_send_cmd_to_zero(CSP_INIT_DIR_ZERO, reply, log);
	if (packet == NULL) {
		ret = -1;
	}

	LOG_INF("===[Start ADCS syshk test]===");
	ret = csp_send_cmd_to_adcs("hwtest syshk -1", log);

	return ret;
}

int csp_test(struct csp_test_result *csp_ret, uint32_t *err_cnt, bool log)
{
	int ret;
	int all_ret = 0;
	uint32_t uptime;
	float zero_temp;
	uint16_t zero_fcount;
	uint8_t csp_id_list[] = {
		CSP_ID_EPS, CSP_ID_SRS3, CSP_ID_ADCS, CSP_ID_ZERO, CSP_ID_PICO,
	};
	const char csp_name_list[][12] = {
		"EPS", "SRS-3", "ADCS Board", "Zero", "Pico",
	};

	for (int i = 0; i < ARRAY_SIZE(csp_id_list); i++) {

		if ((csp_id_list[i] == CSP_ID_ADCS) && test_mode < MAIN_ADCS_ONLY) {
			continue;
		}
		if ((csp_id_list[i] == CSP_ID_ZERO) && test_mode < FULL) {
			continue;
		}
		if ((csp_id_list[i] == CSP_ID_PICO) && test_mode < FULL) {
			continue;
		}

		ret = csp_ping(csp_id_list[i], CSP_TIMEOUT_MSEC, 1, CSP_O_NONE);
		if (ret < 0) {
			csp_ret->ping[i].status = ret;
			csp_ret->ping[i].data = CSP_INVALID_PING;
			HWTEST_LOG_ERR(log, "Ping to %s: Failed", csp_name_list[i]);
			(*err_cnt)++;
			all_ret = -1;
		} else {
			csp_ret->ping[i].status = 0;
			csp_ret->ping[i].data = ret;
			HWTEST_LOG_INF(log, "Ping to %s: %d [ms]", csp_name_list[i], ret);
		}

		ret = csp_get_uptime(csp_id_list[i], CSP_TIMEOUT_MSEC, &uptime);
		if (ret < 0) {
			csp_ret->uptime[i].data = CSP_INVALID_UPTIME;
			HWTEST_LOG_ERR(log, "Uptime of %s: Failed", csp_name_list[i]);
			(*err_cnt)++;
			all_ret = -1;
		} else {
			csp_ret->uptime[i].data = uptime;
			HWTEST_LOG_INF(log, "Uptime of %s: %d [s]", csp_name_list[i], uptime);
		}
		csp_ret->uptime[i].status = ret;
	}

	if (test_mode < FULL) {
		goto end;
	}

	ret = csp_get_zero_temp(&zero_temp, log);
	if (ret < 0) {
		csp_ret->temp_zero.data = CSP_INVALID_TEMP;
		HWTEST_LOG_ERR(log, "Zero Temperature: Failed");
		(*err_cnt)++;
		all_ret = -1;
	} else {
		csp_ret->temp_zero.data = zero_temp;
		HWTEST_LOG_INF(log, "Zero Temperature: %.1f [deg]", (double)zero_temp);
	}
	csp_ret->temp_zero.status = ret;

	ret = csp_get_zero_frame_count(&zero_fcount, log);
	if (ret < 0) {
		csp_ret->fcount_zero.data = CSP_INVALID_COUNT;
		HWTEST_LOG_ERR(log, "Zero Frame Count: Failed");
		(*err_cnt)++;
		all_ret = -1;
	} else {
		csp_ret->fcount_zero.data = zero_fcount;
		HWTEST_LOG_INF(log, "Zero Frame Count: %d", zero_fcount);
	}
	csp_ret->fcount_zero.status = ret;

	if (csp_is_capture_period()) {
		(void)csp_capture_frame_zero();
	}

end:
	return all_ret;
}
```

## src/csp_test.h
```c
/*
 * Copyright (c) 2023 Space Cubics, LLC.
 *
 * SPDX-License-Identifier: Apache-2.0
 */

#pragma once

#include "syshk.h"

#define CSP_TARGET_NUM (5U)

struct csp_test_result {
	struct syshk_i32_data ping[CSP_TARGET_NUM];
	struct syshk_u32_data uptime[CSP_TARGET_NUM];
	struct syshk_float_data temp_zero;
	struct syshk_u16_data fcount_zero;
};

int csp_test(struct csp_test_result *test_ret, uint32_t *err_cnt, bool log);
```

## src/cv.c
```c
/*
 * Copyright (c) 2023 Space Cubics, LLC.
 *
 * SPDX-License-Identifier: Apache-2.0
 */

#include <zephyr/kernel.h>
#include <zephyr/drivers/i2c.h>
#include "cv.h"

#include <zephyr/logging/log.h>
LOG_MODULE_REGISTER(cv, CONFIG_SCSAT1_MAIN_LOG_LEVEL);

#define CV_ADDR (0x42)

#define CV_CH1_SHUNT_REG (0x01)
#define CV_CH1_BUS_REG   (0x02)
#define CV_CH2_SHUNT_REG (0x03)
#define CV_CH2_BUS_REG   (0x04)
#define CV_CH3_SHUNT_REG (0x05)
#define CV_CH3_BUS_REG   (0x06)

static const struct device *get_cv_device(enum io_cv_pos pos)
{
	const struct device *i2c0 = DEVICE_DT_GET(DT_NODELABEL(i2c0));

	switch (pos) {
	case IO_PDU_O4_3V3_SHUNT:
	case IO_PDU_O4_3V3_BUS:
	case IO_VDD_3V3_SYS_SHUNT:
	case IO_VDD_3V3_SYS_BUS:
	case IO_VDD_3V3_SHUNT:
	case IO_VDD_3V3_BUS:
		if (device_is_ready(i2c0)) {
			return i2c0;
		}
		break;
	default:
		break;
	}

	return NULL;
}

static int get_register_addr(enum io_cv_pos pos, uint16_t *addr)
{
	int ret = 0;

	switch (pos) {
	case IO_PDU_O4_3V3_SHUNT:
		*addr = CV_CH1_SHUNT_REG;
		break;
	case IO_PDU_O4_3V3_BUS:
		*addr = CV_CH1_BUS_REG;
		break;
	case IO_VDD_3V3_SYS_SHUNT:
		*addr = CV_CH2_SHUNT_REG;
		break;
	case IO_VDD_3V3_SYS_BUS:
		*addr = CV_CH2_BUS_REG;
		break;
	case IO_VDD_3V3_SHUNT:
		*addr = CV_CH3_SHUNT_REG;
		break;
	case IO_VDD_3V3_BUS:
		*addr = CV_CH3_BUS_REG;
		break;
	default:
		ret = -ENODEV;
		break;
	}

	return ret;
}

static int32_t convert_cv_shunt(int16_t raw)
{
	return ((raw >> 3) * 40);
}

static int32_t convert_cv_bus(int16_t raw)
{
	return ((raw >> 3) * 8);
}

static int convert_cv(enum io_cv_pos pos, uint16_t raw, int32_t *cv)
{
	int ret = 0;

	switch (pos) {
	case IO_PDU_O4_3V3_SHUNT:
		*cv = convert_cv_shunt(raw);
		break;
	case IO_PDU_O4_3V3_BUS:
		*cv = convert_cv_bus(raw);
		break;
	case IO_VDD_3V3_SYS_SHUNT:
		*cv = convert_cv_shunt(raw);
		break;
	case IO_VDD_3V3_SYS_BUS:
		*cv = convert_cv_bus(raw);
		break;
	case IO_VDD_3V3_SHUNT:
		*cv = convert_cv_shunt(raw);
		break;
	case IO_VDD_3V3_BUS:
		*cv = convert_cv_bus(raw);
		break;
	default:
		ret = -ENODEV;
		break;
	}

	return ret;
}

int get_ioboard_cv(enum io_cv_pos pos, uint32_t *cv)
{
	int ret;
	uint8_t data[2];
	uint16_t reg;
	uint16_t raw;

	const struct device *dev = get_cv_device(pos);
	if (dev == NULL) {
		LOG_ERR("I2C device is not ready. (pos: %d)", pos);
		ret = -ENODEV;
		goto end;
	}

	ret = get_register_addr(pos, &reg);
	if (ret < 0) {
		goto end;
	}

	ret = i2c_burst_read(dev, CV_ADDR, reg, data, ARRAY_SIZE(data));
	if (ret < 0) {
		LOG_ERR("Failed to i2c_burst_read for Current/Voltage Monitor (pos: %d) (%d)", pos,
			ret);
		goto end;
	}
	raw = data[0] << 8 | data[1];

	ret = convert_cv(pos, raw, cv);
end:
	return ret;
}
```

## src/cv.h
```c
/*
 * Copyright (c) 2023 Space Cubics, LLC.
 *
 * SPDX-License-Identifier: Apache-2.0
 */

#pragma once

#include <stdint.h>

enum io_cv_pos {
	IO_PDU_O4_3V3_SHUNT,
	IO_PDU_O4_3V3_BUS,
	IO_VDD_3V3_SYS_SHUNT,
	IO_VDD_3V3_SYS_BUS,
	IO_VDD_3V3_SHUNT,
	IO_VDD_3V3_BUS,
};

int get_ioboard_cv(enum io_cv_pos pos, uint32_t *cv);
```

## src/cv_test.c
```c
/*
 * Copyright (c) 2023 Space Cubics, LLC.
 *
 * SPDX-License-Identifier: Apache-2.0
 */

#include <zephyr/kernel.h>
#include "common.h"
#include "cv_main.h"
#include "sc_fpgamon.h"
#include "cv_test.h"

#include <zephyr/logging/log.h>
LOG_MODULE_REGISTER(cv_test, CONFIG_SCSAT1_MAIN_LOG_LEVEL);

#define CV_INVALID_FLOAT (0.0f)
#define CV_INVALID_UINT  (0U)

static int cv_obc_test(struct main_cv_test_result *cv_ret, uint32_t *err_cnt, bool log)
{
	int ret;
	int all_ret = 0;
	int32_t cv;
	enum obc_cv_pos obc_pos_list[] = {
		OBC_1V0_SHUNT,      OBC_1V0_BUS,      OBC_1V8_SHUNT,      OBC_1V8_BUS,
		OBC_3V3_SHUNT,      OBC_3V3_BUS,      OBC_3V3_SYSA_SHUNT, OBC_3V3_SYSA_BUS,
		OBC_3V3_SYSB_SHUNT, OBC_3V3_SYSB_BUS, OBC_3V3_IO_SHUNT,   OBC_3V3_IO_BUS,
	};
	const char obc_pos_name[][20] = {
		"OBC_1V0 Shunt",      "OBC_1V0 Bus",      "OBC_1V8 Shunt",      "OBC_1V8 Bus",
		"OBC_3V3 Shunt",      "OBC_3V3 Bus",      "OBC_3V3_SYSA Shunt", "OBC_3V3_SYSA Bus",
		"OBC_3V3_SYSB Shunt", "OBC_3V3_SYSB Bus", "OBC_3V3_IO Shunt",   "OBC_3V3_IO Bus",
	};
	const char obc_unit_name[][5] = {
		"[uv]", "[mv]", "[uv]", "[mv]", "[uv]", "[mv]",
		"[uv]", "[mv]", "[uv]", "[mv]", "[uv]", "[mv]",
	};

	for (int i = 0; i < ARRAY_SIZE(obc_pos_list); i++) {
		ret = sc_bhm_get_obc_cv(obc_pos_list[i], &cv);
		if (ret < 0) {
			cv_ret->obc_cv[i].data = CV_INVALID_UINT;
			HWTEST_LOG_ERR(log, "%s: Failed", obc_pos_name[i]);
			(*err_cnt)++;
			all_ret = -1;
		} else {
			cv_ret->obc_cv[i].data = cv;
			HWTEST_LOG_INF(log, "%s: %d %s", obc_pos_name[i], cv, obc_unit_name[i]);
		}
		cv_ret->obc_cv[i].status = ret;
	}

	return all_ret;
}

static int cv_xadc_test(struct main_cv_test_result *cv_ret, uint32_t *err_cnt, bool log)
{
	int ret;
	int all_ret = 0;
	float cv;
	enum xadc_cv_pos xadc_pos_list[] = {
		OBC_XADC_VCCINT,
		OBC_XADC_VCCAUX,
		OBC_XADC_VCCBRAM,
	};
	const char xadc_pos_name[][18] = {
		"OBC_XADC VCCINT",
		"OBC_XADC VCCAUX",
		"OBC_XADC VCCBRAM",
	};

	for (int i = 0; i < ARRAY_SIZE(xadc_pos_list); i++) {
		ret = sc_bhm_get_xadc_cv(xadc_pos_list[i], &cv);
		if (ret < 0) {
			cv_ret->xadc_cv[i].data = CV_INVALID_FLOAT;
			HWTEST_LOG_ERR(log, "%s: Failed", xadc_pos_name[i]);
			(*err_cnt)++;
			all_ret = -1;
		} else {
			cv_ret->xadc_cv[i].data = cv;
			HWTEST_LOG_INF(log, "%s: %.4f [v]", xadc_pos_name[i], (double)cv);
		}
		cv_ret->xadc_cv[i].status = ret;
	}

	return all_ret;
}

static int cv_ioboard_test(struct main_cv_test_result *cv_ret, uint32_t *err_cnt, bool log)
{
	int ret;
	int all_ret = 0;
	int32_t cv;
	enum io_cv_pos io_pos_list[] = {
		IO_PDU_O4_3V3_SHUNT, IO_PDU_O4_3V3_BUS, IO_VDD_3V3_SYS_SHUNT,
		IO_VDD_3V3_SYS_BUS,  IO_VDD_3V3_SHUNT,  IO_VDD_3V3_BUS,
	};
	const char io_pos_name[][22] = {
		"IO_PDU_04_3V3 Shunt", "IO_PDU_04_3V3 Bus", "IO_VDD_3V3_SYS Shunt",
		"IO_VDD_3V3_SYS Bus",  "IO_VDD_3V3 Shunt",  "IO_VDD_3V3 Bus",
	};
	const char io_unit_name[][5] = {
		"[uv]", "[mv]", "[uv]", "[mv]", "[uv]", "[mv]",
	};

	for (int i = 0; i < ARRAY_SIZE(io_pos_list); i++) {
		ret = get_ioboard_cv(io_pos_list[i], &cv);
		if (ret < 0) {
			cv_ret->ioboard_cv[i].data = CV_INVALID_UINT;
			HWTEST_LOG_ERR(log, "%s: Failed", io_pos_name[i]);
			(*err_cnt)++;
			all_ret = -1;
		} else {
			cv_ret->ioboard_cv[i].data = cv;
			HWTEST_LOG_INF(log, "%s: %d %s", io_pos_name[i], cv, io_unit_name[i]);
		}
		cv_ret->ioboard_cv[i].status = ret;
	}

	return all_ret;
}

int cv_test(struct main_cv_test_result *cv_ret, uint32_t *err_cnt, bool log)
{
	int ret;
	int all_ret = 0;

	ret = cv_obc_test(cv_ret, err_cnt, log);
	if (ret < 0) {
		all_ret = -1;
	}

	ret = cv_xadc_test(cv_ret, err_cnt, log);
	if (ret < 0) {
		all_ret = -1;
	}

	ret = cv_ioboard_test(cv_ret, err_cnt, log);
	if (ret < 0) {
		all_ret = -1;
	}

	return all_ret;
}
```

## src/cv_test.h
```c
/*
 * Copyright (c) 2023 Space Cubics, LLC.
 *
 * SPDX-License-Identifier: Apache-2.0
 */

#pragma once

#include "syshk.h"

#define CV_OBC_POS_NUM     (12U)
#define CV_XADC_POS_NUM    (3U)
#define CV_IOBOARD_POS_NUM (6U)

struct main_cv_test_result {
	struct syshk_u32_data obc_cv[CV_OBC_POS_NUM];
	struct syshk_float_data xadc_cv[CV_XADC_POS_NUM];
	struct syshk_u32_data ioboard_cv[CV_IOBOARD_POS_NUM];
};

int cv_test(struct main_cv_test_result *cv_ret, uint32_t *err_cnt, bool log);
```

## src/dstrx3_test.c
```c
/*
 * Copyright (c) 2024 Space Cubics, LLC.
 *
 * SPDX-License-Identifier: Apache-2.0
 */

#include <zephyr/kernel.h>
#include "common.h"
#include "dstrx3_test.h"

#include <zephyr/logging/log.h>
LOG_MODULE_REGISTER(dstrx3_test, CONFIG_SCSAT1_MAIN_LOG_LEVEL);

static void dstrx3_print_hk(struct sc_dstrx3_hk *hk)
{
	LOG_INF("DSTRX-3 HK FREE_COUNTER     : %d", hk->free_count);
	LOG_INF("DSTRX-3 HK WDT_COUNTER      : %d", hk->wdt_count);
	LOG_INF("DSTRX-3 HK RSSI             : %d [dBm] (raw: %d)", -(hk->rssi + 16), hk->rssi);
	LOG_INF("DSTRX-3 HK RCV_FREQ         : %.4f [Hz] (raw: %d)",
		(2105.350 + (hk->rcv_freq * 100)), hk->rcv_freq);
	LOG_INF("DSTRX-3 HK TEMPERATURE      : %d [deg]", hk->temperature);
	LOG_INF("DSTRX-3 HK VOLTAGE          : %.04f [v] (raw: %d)",
		(double)((hk->voltage / 256.0f) * 2.5f), hk->voltage);
	LOG_INF("DSTRX-3 HK TX_PWR           : %.04f [dBm] (raw: %d)",
		((0.2473 * hk->tx_power) + 0.99), hk->tx_power);
	LOG_INF("DSTRX-3 HK CARRIER_LOCK     : %d", hk->carrier_lock);
	LOG_INF("DSTRX-3 HK SUB_CARRIER_LOCK : %d", hk->sub_carrier_lock);
	LOG_INF("DSTRX-3 HK TX_PWR_SET       : %d", hk->tx_power_set);
	LOG_INF("DSTRX-3 HK BIT_RATE_SET     : %d", hk->bit_rate_set);
	LOG_INF("DSTRX-3 HK PROG_NO          : %d", hk->program_no);
	LOG_INF("DSTRX-3 HK CHK_SUM          : %d", hk->checksum);
}

int dstrx3_test(struct dstrx3_test_ret *dstrx3_ret, uint32_t *err_cnt, bool log)
{
	int ret;
	const struct device *dev = DEVICE_DT_GET(DT_NODELABEL(dstrx));
	struct sc_dstrx3_hk hk;

	ret = sc_dstrx3_get_hk_telemetry(dev, &hk);
	if (ret < 0) {
		memset(dstrx3_ret, 0, sizeof(*dstrx3_ret));
		HWTEST_LOG_ERR(log, "DSTRX-3 HK: Failed");
		(*err_cnt)++;
	} else {
		dstrx3_ret->free_count = hk.free_count;
		dstrx3_ret->wdt_count = hk.wdt_count;
		dstrx3_ret->rssi = hk.rssi;
		dstrx3_ret->rcv_freq = hk.rcv_freq;
		dstrx3_ret->temperature = hk.temperature;
		dstrx3_ret->voltage = hk.voltage;
		dstrx3_ret->tx_power = hk.tx_power;
		dstrx3_ret->carrier_lock = hk.carrier_lock;
		dstrx3_ret->sub_carrier_lock = hk.sub_carrier_lock;
		dstrx3_ret->tx_power_set = hk.tx_power_set;
		dstrx3_ret->bit_rate_set = hk.bit_rate_set;
		dstrx3_ret->program_no = hk.program_no;
		dstrx3_ret->checksum = hk.checksum;
		if (log) {
			dstrx3_print_hk(&hk);
		}
	}
	dstrx3_ret->status = ret;

	return ret;
}

void dstrx3_downlink_loop_test(uint32_t loop, uint8_t flags)
{
	const struct device *dev = DEVICE_DT_GET(DT_NODELABEL(dstrx));
	uint8_t data[4];

	sc_dstrx3_enable_downlink(dev);

	sc_dstrx3_set_downlink_control(dev, flags);

	for (uint32_t i = 0; i < loop; i++) {
		data[0] = i % 0xFF;
		data[1] = data[0] + 1;
		data[2] = data[1] + 1;
		data[3] = data[2] + 1;
		sc_dstrx3_downlink_data(dev, data, 4);
		LOG_INF("Downlink 0x%02x 0x%02x 0x%02x 0x%02x to Ground with flags 0x%02x", data[0],
			data[1], data[2], data[3], flags);
		k_sleep(K_SECONDS(1));
	}

	sc_dstrx3_disable_downlink(dev);
}

void dstrx3_uplink_test(const char *arg)
{
	const struct device *dev = DEVICE_DT_GET(DT_NODELABEL(dstrx));
	uint8_t count;
	uint8_t status;
	int ret;
	uint8_t data[SC_DSTRX3_MAX_UPLINK_BUFFER_SIZE];
	uint16_t size;

	if (strcmp(arg, "clear") == 0) {
		LOG_INF("Clear uplink buffer");
		sc_dstrx3_clear_uplink_buffer(dev);
		goto end;
	} else if (strcmp(arg, "discard") == 0) {
		LOG_INF("Discard uplink data");
		sc_dstrx3_discard_uplink_data(dev);
		goto end;
	}

	sc_dstrx3_get_uplink_status(dev, &count, &status);
	LOG_INF("Uplink buffer count: %d, status: 0x%08x", count, status);

	ret = sc_dstrx3_get_uplink_data(dev, data, &size);
	if (ret < 0) {
		LOG_ERR("Failed to get the uplink data (%d)", ret);
		goto end;
	}

	LOG_INF("Uplink data size: %d [byte]", size);
	LOG_HEXDUMP_INF(data, size, "Uplink data (hex)");

end:
	return;
}
```

## src/dstrx3_test.h
```c
/*
 * Copyright (c) 2024 Space Cubics, LLC.
 *
 * SPDX-License-Identifier: Apache-2.0
 */

#pragma once

#include "sc_dstrx3.h"

struct dstrx3_test_ret {
	int8_t status;
	uint8_t free_count;
	uint8_t wdt_count;
	uint8_t rssi;
	int16_t rcv_freq;
	int8_t temperature;
	uint8_t voltage;
	uint8_t tx_power;
	uint8_t carrier_lock: 1;
	uint8_t sub_carrier_lock: 1;
	uint8_t tx_power_set: 4;
	uint8_t bit_rate_set: 2;
	uint8_t program_no;
	uint8_t checksum;
} __attribute__((__packed__));

int dstrx3_test(struct dstrx3_test_ret *dstrx3_ret, uint32_t *err_cnt, bool log);
void dstrx3_downlink_loop_test(uint32_t loop, uint8_t flags);
void dstrx3_uplink_test(const char *arg);
```

## src/loop_test.c
```c
/*
 * Copyright (c) 2023 Space Cubics, LLC.
 *
 * SPDX-License-Identifier: Apache-2.0
 */

#include <zephyr/kernel.h>
#include "common.h"
#include "loop_test.h"
#include "pwrctrl_main.h"
#include "temp_test.h"
#include "cv_test.h"
#include "csp_test.h"
#include "sunsens_test.h"
#include "mgnm_test.h"
#include "dstrx3_test.h"
#include "mtq.h"

#include <zephyr/logging/log.h>
LOG_MODULE_REGISTER(loop_test, CONFIG_SCSAT1_MAIN_LOG_LEVEL);

struct k_event loop_event;
extern enum hwtest_mode test_mode;

static void update_mtq_idx(uint8_t *axes_idx, uint8_t *pol_idx)
{
	if (*pol_idx < 2) {
		(*pol_idx)++;
	} else {
		*pol_idx = 0;
		(*axes_idx)++;
	}

	if (*axes_idx >= 3) {
		*axes_idx = 0;
	}
}

static int one_loop(uint32_t *err_cnt)
{
	int ret;
	int all_ret = 0;
	struct main_temp_test_result temp_ret;
	struct main_cv_test_result cv_ret;
	struct csp_test_result csp_ret;
	struct sunsens_test_ret sunsens_ret;
	struct mgnm_test_ret mgnm_ret;
	struct dstrx3_test_ret dstrx3_ret;

	LOG_INF("===[Temp Test Start (total err: %d)]===", *err_cnt);
	ret = temp_test(&temp_ret, err_cnt, LOG_ENABLE);
	if (ret < 0) {
		all_ret = -1;
	}

	k_sleep(K_MSEC(100));

	LOG_INF("===[CV Test Start (total err: %d)]===", *err_cnt);
	ret = cv_test(&cv_ret, err_cnt, LOG_ENABLE);
	if (ret < 0) {
		all_ret = -1;
	}

	k_sleep(K_MSEC(100));

	LOG_INF("===[CSP Test Start (total err: %d)]===", *err_cnt);
	ret = csp_test(&csp_ret, err_cnt, LOG_ENABLE);
	if (ret < 0) {
		all_ret = -1;
	}

	k_sleep(K_MSEC(100));

	LOG_INF("===[Sun Sensor Test Start (total err: %d)]===", *err_cnt);
	ret = sunsens_test(&sunsens_ret, err_cnt, LOG_ENABLE);
	if (ret < 0) {
		all_ret = -1;
	}

	k_sleep(K_MSEC(100));

	LOG_INF("===[Magnetometer Test Start (total err: %d)]===", *err_cnt);
	ret = mgnm_test(&mgnm_ret, err_cnt, LOG_ENABLE);
	if (ret < 0) {
		all_ret = -1;
	}

	k_sleep(K_MSEC(100));

	if (test_mode < MAIN_ONLY) {
		goto end;
	}

	LOG_INF("===[DSTRX-3 Test Start (total err: %d)]===", *err_cnt);
	ret = dstrx3_test(&dstrx3_ret, err_cnt, LOG_ENABLE);
	if (ret < 0) {
		all_ret = -1;
	}

	k_sleep(K_MSEC(100));

end:
	return all_ret;
}

static bool is_loop_stop(void)
{
	if (k_event_wait(&loop_event, LOOP_STOP_EVENT, false, K_NO_WAIT) != 0) {
		return true;
	}

	return false;
}

int loop_test(int32_t loop_count, uint32_t *err_cnt)
{
	int ret;
	int all_ret = 0;
	float duty = 1.0;
	enum mtq_axes axes_list[] = {
		MTQ_AXES_MAIN_X,
		MTQ_AXES_MAIN_Y,
		MTQ_AXES_MAIN_Z,
	};
	enum mtq_polarity pol_list[] = {
		MTQ_POL_PLUS,
		MTQ_POL_MINUS,
		MTQ_POL_NON,
	};
	uint8_t axes_idx = 0;
	uint8_t pol_idx = 0;

	if (loop_count < 0) {
		loop_count = INT32_MAX;
	}

	if (test_mode == FULL) {
		LOG_INF("===[Init photo directory on Zero)]===");
		csp_test_init();
		k_sleep(K_SECONDS(10));
	}

	for (int i = 1; i <= loop_count; i++) {
		if (is_loop_stop()) {
			break;
		}

		LOG_INF("===[Loop Test %d Start (total err: %d)]===", i, *err_cnt);

		LOG_INF("===[MTQ Start (total err: %d)]===", *err_cnt);
		ret = mtq_start(axes_list[axes_idx], pol_list[pol_idx], duty);
		if (ret < 0) {
			(*err_cnt)++;
			all_ret = -1;
		}

		for (int j = 0; j < 5; j++) {
			ret = one_loop(err_cnt);
			if (ret < 0) {
				all_ret = -1;
			}
		}

		LOG_INF("===[MTQ Stop (total err: %d)]===", *err_cnt);
		ret = mtq_stop(axes_list[axes_idx]);
		if (ret < 0) {
			(*err_cnt)++;
			all_ret = -1;
		}

		update_mtq_idx(&axes_idx, &pol_idx);

		LOG_INF("===[Loop Test %d Finish (total err: %d))]===", i, *err_cnt);
	}

	return all_ret;
}
```
