## CMakeLists.txt
```
# SPDX-License-Identifier: Apache-2.0

cmake_minimum_required(VERSION 3.20.0)

set(BOARD scsat1_adcs)
set(BOARD_ROOT ${CMAKE_CURRENT_LIST_DIR}/../../../)

find_package(Zephyr REQUIRED HINTS $ENV{ZEPHYR_BASE})
project(scsat1-adcs)

target_sources(app PRIVATE src/main.c)
target_sources(app PRIVATE src/temp_test.c)
target_sources(app PRIVATE src/cv.c)
target_sources(app PRIVATE src/cv_test.c)
target_sources(app PRIVATE src/imu.c)
target_sources(app PRIVATE src/imu_test.c)
target_sources(app PRIVATE src/gnss.c)
target_sources(app PRIVATE src/gnss_test.c)
target_sources(app PRIVATE src/csp.c)
target_sources(app PRIVATE src/rw.c)
target_sources(app PRIVATE src/rw_test.c)
target_sources(app PRIVATE src/adcs_init.c)
target_sources(app PRIVATE src/loop_test.c)
target_sources(app PRIVATE src/syshk.c)
target_sources(app PRIVATE src/syshk_test.c)
```

## Kconfig
```
mainmenu "SC-Sat1 ADCS Board"

menu "Application"

config SCSAT1_ADCS_AUTO_RUN_HWTEST
	bool "Enable auto run for HW test"
	default n
	help
	  Enable auto run for HW test.

module = SCSAT1_ADCS
module-str = SC-Sat1 ADCS Board
source "subsys/logging/Kconfig.template.log_config"

endmenu

menu "Zephyr"
source "Kconfig.zephyr"
endmenu
```

## prj.conf
```kconfig
CONFIG_LIBCSP=y
CONFIG_PICOLIBC=y
CONFIG_CAN=y
CONFIG_I2C=y
CONFIG_SPI=y
CONFIG_SPI_EXTENDED_MODES=y
CONFIG_PWM=y
CONFIG_LOG=y
CONFIG_EVENTS=y
CONFIG_SHELL=y
CONFIG_SHELL_PROMPT_UART="adcs:~$ "
CONFIG_LOG_BUFFER_SIZE=5120
CONFIG_MAIN_STACK_SIZE=4096
CONFIG_PICOLIBC_IO_FLOAT=y
# For CSP
CONFIG_LIBCSP=y
CONFIG_CSP_USE_RTABLE=n
CONFIG_EVENTS=y
CONFIG_HEAP_MEM_POOL_SIZE=2048
# For NOR flash
CONFIG_FLASH=y
CONFIG_SPI_NOR=y
CONFIG_FLASH_MAP=y
CONFIG_FLASH_MAP_LABELS=y
# For LittleFS
CONFIG_FILE_SYSTEM=y
CONFIG_FILE_SYSTEM_LITTLEFS=y
```

## src/main.c
```c
/*
 * Copyright (c) 2023 Space Cubics, LLC.
 *
 * SPDX-License-Identifier: Apache-2.0
 */

#include <stdlib.h>
#include <zephyr/kernel.h>
#include <zephyr/shell/shell_uart.h>
#include "common.h"
#include "csp.h"
#include "wdog.h"
#include "temp_test.h"
#include "cv_test.h"
#include "imu_test.h"
#include "gnss_test.h"
#include "rw_test.h"
#include "adcs_init.h"
#include "loop_test.h"
#include "syshk_test.h"
#include "data_nor.h"
#include "sc_fpgasys.h"
#include "sc_fpgamon.h"
#include "version.h"

#include <zephyr/logging/log.h>
LOG_MODULE_REGISTER(adcs_main, CONFIG_SCSAT1_ADCS_LOG_LEVEL);

#define CMD_HANDLER_PRIO (0U)
#define CMD_EXEC_EVENT   (1U)
#define BOOT_COUNT_FILE  CONFIG_SC_LIB_FLASH_DATA_STORE_MNT_POINT "/boot.count"

char last_cmd[32];

K_THREAD_STACK_DEFINE(cmd_thread_stack, 4096);
static struct k_thread cmd_thread;
static struct k_event exec_event;
extern struct k_event loop_event;

static void sc_adcs_print_fpga_ids(void)
{
	LOG_INF("* FSW Version       : %s", ADCS_HWTEST_VERSION);
	LOG_INF("* Boot CFG Memory   : %d", sc_get_boot_cfgmem());
	LOG_INF("* FPGA Boot Status  : 0x%x", sc_get_bootsts());
	LOG_INF("* IP Version        : %08x", sc_get_fpga_ip_ver());
	LOG_INF("* Build Information : %08x", sc_get_fpga_build_hash());
	LOG_INF("* Device DNA 1      : %08x", sc_get_fpga_dna_1());
	LOG_INF("* Device DNA 2      : %08x",sc_get_fpga_dna_2());
}

static void cmd_handler(void *p1, void *p2, void *p3)
{
	int ret = 0;
	uint32_t err_cnt = 0;
	char *cmd = (char *)p1;
	char *arg = (char *)p2;
	struct adcs_temp_test_result temp_ret;
	struct adcs_cv_test_result cv_ret;
	struct imu_test_result imu_ret;
	struct gnss_hwmon_result hwmon_ret;
	struct gnss_bestpos_result bestpos_ret;

	k_event_set(&exec_event, CMD_EXEC_EVENT);

	ARG_UNUSED(p3);

	if (strcmp(cmd, "info") == 0) {
		sc_adcs_print_fpga_ids();
	} else if (strcmp(cmd, "init") == 0) {
		ret = adcs_init(&err_cnt);
	} else if (strcmp(cmd, "off") == 0) {
		ret = adcs_off(&err_cnt);
	} else if (strcmp(cmd, "temp") == 0) {
		ret = temp_test(&temp_ret, &err_cnt, LOG_ENABLE);
	} else if (strcmp(cmd, "cv") == 0) {
		ret = cv_test(&cv_ret, &err_cnt, LOG_ENABLE);
	} else if (strcmp(cmd, "imu") == 0) {
		ret = imu_test(&imu_ret, &err_cnt, LOG_ENABLE);
	} else if (strcmp(cmd, "gnss") == 0) {
		ret = gnss_test(&hwmon_ret, &bestpos_ret, &err_cnt, LOG_ENABLE);
	} else if (strcmp(cmd, "rw") == 0) {
		ret = rw_test(&err_cnt);
	} else if (strcmp(cmd, "loop") == 0) {
		k_event_set(&loop_event, LOOP_START_EVENT);
		ret = loop_test(atoi(arg), &err_cnt);
		k_event_clear(&loop_event, LOOP_STOP_EVENT);
	} else if (strcmp(cmd, "syshk") == 0) {
		k_event_set(&loop_event, LOOP_START_EVENT);
		ret = syshk_test(atoi(arg), &err_cnt);
		k_event_clear(&loop_event, LOOP_STOP_EVENT);
	} else {
		goto end;
	}

	if (ret < 0) {
		LOG_ERR("%s test Failed. eror count: %d", cmd, err_cnt);
	} else {
		LOG_INF("%s test successed.", cmd);
	}
end:
	k_event_clear(&exec_event, CMD_EXEC_EVENT);

	return;
}

static int start_cmd_thread(const struct shell *sh, size_t argc, char **argv)
{
	int ret = 0;
	k_tid_t cmd_tid;

	strncpy(last_cmd, sh->ctx->temp_buff, MIN(sh->ctx->cmd_tmp_buff_len, sizeof(last_cmd) - 1));

	if (argc < 1) {
		shell_error(sh, "Invalid argument");
		ret = -EINVAL;
		goto end;
	}

	if (k_event_wait(&exec_event, CMD_EXEC_EVENT, false, K_NO_WAIT) != 0) {
		shell_error(sh, "Now another command is executing");
		ret = -EBUSY;
		goto end;
	}

	cmd_tid = k_thread_create(&cmd_thread, cmd_thread_stack,
				  K_THREAD_STACK_SIZEOF(cmd_thread_stack),
				  (k_thread_entry_t)cmd_handler, argv[0], argv[1], NULL,
				  CMD_HANDLER_PRIO, 0, K_NO_WAIT);
	if (!cmd_tid) {
		shell_error(sh, "Failed to create command thread");
		ret = ENOSPC;
	}

end:
	return ret;
}

static int stop_cmd(const struct shell *sh, size_t argc, char **argv)
{
	strncpy(last_cmd, sh->ctx->temp_buff, MIN(sh->ctx->cmd_tmp_buff_len, sizeof(last_cmd) - 1));
	k_event_set(&loop_event, LOOP_STOP_EVENT);
	return 0;
}

int main(void)
{
	int ret;

	printk("This is for HW test program for %s\n", CONFIG_BOARD);

	datafs_init();

	start_kick_wdt_thread();

	sc_adcs_print_fpga_ids();

	k_event_init(&exec_event);

	update_boot_count(BOOT_COUNT_FILE);

	ret = csp_enable();
	if (ret < 0) {
		LOG_ERR("Failed to enable the CSP. (%d)", ret);
	} else {
		LOG_INF("Enable the CSP");
	}

	shell_execute_cmd(shell_backend_uart_get_ptr(), "hwtest init");

	if (IS_ENABLED(CONFIG_SCSAT1_ADCS_AUTO_RUN_HWTEST)) {
		k_sleep(K_SECONDS(30));

		shell_execute_cmd(shell_backend_uart_get_ptr(), "hwtest syshk -1");
	}

	return 0;
}

SHELL_STATIC_SUBCMD_SET_CREATE(
	sub_hwtest, SHELL_CMD(info, NULL, "ADCS Board Information", start_cmd_thread),
	SHELL_CMD(init, NULL, "ADCS Board Initialization", start_cmd_thread),
	SHELL_CMD(off, NULL, "Turn off the each power and CAN", start_cmd_thread),
	SHELL_CMD(temp, NULL, "Temperature test command", start_cmd_thread),
	SHELL_CMD(cv, NULL, "Current/Voltage test command", start_cmd_thread),
	SHELL_CMD(imu, NULL, "IMU test command", start_cmd_thread),
	SHELL_CMD(gnss, NULL, "GNSS test command", start_cmd_thread),
	SHELL_CMD(rw, NULL, "Reaction Wheel test command", start_cmd_thread),
	SHELL_CMD(loop, NULL, "Loop test command", start_cmd_thread),
	SHELL_CMD(syshk, NULL, "System HK test command", start_cmd_thread), SHELL_SUBCMD_SET_END);
SHELL_CMD_REGISTER(hwtest, &sub_hwtest, "SC-Sat1 HW test commands", NULL);
SHELL_CMD_REGISTER(stop, NULL, "SC-Sat1 HW test stop", stop_cmd);
```

## src/adcs_init.c
```c
/*
 * Copyright (c) 2023 Space Cubics, LLC.
 *
 * SPDX-License-Identifier: Apache-2.0
 */

#include <zephyr/kernel.h>
#include "pwrctrl_adcs.h"
#include "sc_fpgamon.h"
#include "gnss.h"
#include "imu.h"

#include <zephyr/logging/log.h>
LOG_MODULE_REGISTER(adcs_init, CONFIG_SCSAT1_ADCS_LOG_LEVEL);

int adcs_init(uint32_t *err_cnt)
{
	int ret;
	int all_ret = 0;

	ret = sc_bhm_enable();
	if (ret < 0) {
		LOG_ERR("Failed to enable the BHM. (%d)", ret);
		(*err_cnt)++;
		all_ret = -1;
	} else {
		LOG_INF("Enable the BHM");
	}

	sc_adcs_power_enable(DRV_PWR);
	LOG_INF("Power on the DRV");

	k_sleep(K_SECONDS(1));

	sc_adcs_power_enable(IMU_PWR);
	imu_enable();
	LOG_INF("Power on the IMU");

	k_sleep(K_SECONDS(1));

	sc_adcs_power_enable(GPS_PWR);
	ret = gnss_enable();
	if (ret < 0) {
		LOG_ERR("Failed to enable the GNSS. (%d)", ret);
		(*err_cnt)++;
		all_ret = -1;
	} else {
		LOG_INF("Power on the GNSS");
	}

	return all_ret;
}

int adcs_off(uint32_t *err_cnt)
{
	int ret;
	int all_ret = 0;

	ret = sc_bhm_disable();
	if (ret < 0) {
		LOG_ERR("Failed to disble the BHM. (%d)", ret);
		(*err_cnt)++;
		all_ret = -1;
	} else {
		LOG_INF("Disable the BHM");
	}

	sc_adcs_power_disable(DRV_PWR);
	LOG_INF("Power off the DRV");

	k_sleep(K_SECONDS(1));

	sc_adcs_power_disable(IMU_PWR);
	imu_disable();
	LOG_INF("Power off the IMU");

	k_sleep(K_SECONDS(1));

	sc_adcs_power_disable(GPS_PWR);
	gnss_disable();
	LOG_INF("Power off the GNSS");

	return all_ret;
}
```

## src/adcs_init.h
```c
/*
 * Copyright (c) 2023 Space Cubics, LLC.
 *
 * SPDX-License-Identifier: Apache-2.0
 */

#pragma once

#include <stdint.h>

int adcs_init(uint32_t *err_cnt);
int adcs_off(uint32_t *err_cnt);
```

## src/common.h
```c
/*
 * Copyright (c) 2024 Space Cubics, LLC.
 *
 * SPDX-License-Identifier: Apache-2.0
 */

#pragma once

#include <zephyr/logging/log.h>

#define CSP_ID_MAIN      (1U)
#define CSP_ID_ADCS      (2U)
#define CSP_ID_PYLD      (3U)
#define CSP_ID_EPS       (4U)
#define CSP_ID_SRS3      (5U)
#define CSP_ID_GND       (10U)
#define LOOP_START_EVENT (0U)
#define LOOP_STOP_EVENT  (1U)
#define LOG_ENABLE       (true)
#define LOG_DISABLE      (false)

#define HWTEST_LOG_INF(log, format, ...)                                                           \
	if (log) {                                                                                 \
		LOG_INF(format, ##__VA_ARGS__);                                                    \
	}
#define HWTEST_LOG_DBG(log, format, ...)                                                           \
	if (log) {                                                                                 \
		LOG_DBG(format, ##__VA_ARGS__);                                                    \
	}
#define HWTEST_LOG_ERR(log, format, ...)                                                           \
	if (log) {                                                                                 \
		LOG_ERR(format, ##__VA_ARGS__);                                                    \
	}

#define SYSHK_FIFO_NUM (10U)

struct all_test_result {
	uint32_t loop_count;
	uint32_t err_cnt;
	char version[32];
	char last_cmd[32];
};
```

## src/csp.c
```c
/*
 * Copyright (c) 2023 Space Cubics, LLC.
 *
 * SPDX-License-Identifier: Apache-2.0
 */
#include <string.h>
#include <unistd.h>
#include <stdlib.h>
#include <csp/csp.h>
#include <csp/drivers/can_zephyr.h>
#include <zephyr/device.h>
#include <zephyr/shell/shell_uart.h>
#include "common.h"
#include "temp_test.h"
#include "cv_test.h"
#include "imu_test.h"
#include "gnss_test.h"
#include "rw_test.h"
#include "syshk.h"

#include <zephyr/logging/log.h>
LOG_MODULE_REGISTER(csp, CONFIG_SCSAT1_ADCS_LOG_LEVEL);

#define ROUTER_STACK_SIZE (256U)
#define SERVER_STACK_SIZE (1024U)
#define ROUTER_PRIO       (0U)
#define SERVER_PRIO       (0U)

#define CSP_GET_SYSHK_PORT (10U)
#define CSP_SHELL_CMD_PORT (11U)

extern uint8_t syshk_tail;
extern struct rw_count_data rw_data_fifo[SYSHK_FIFO_NUM];
extern struct adcs_temp_test_result temp_ret_fifo[SYSHK_FIFO_NUM];
extern struct adcs_cv_test_result cv_ret_fifo[SYSHK_FIFO_NUM];
extern struct imu_test_result imu_ret_fifo[SYSHK_FIFO_NUM];
extern struct gnss_hwmon_result gnss_hwmon_ret_fifo[SYSHK_FIFO_NUM];
extern struct gnss_bestpos_result gnss_bestpos_ret_fifo[SYSHK_FIFO_NUM];
extern struct all_test_result test_ret_fifo[SYSHK_FIFO_NUM];

static csp_iface_t *can_iface = NULL;

void server();

static void *router_task(void *param)
{

	while (true) {
		csp_route_work();
	}

	return NULL;
}

static void *server_task(void *p1, void *p2, void *p3)
{

	ARG_UNUSED(p1);
	ARG_UNUSED(p2);
	ARG_UNUSED(p3);

	server();

	return NULL;
}

K_THREAD_DEFINE(router_id, ROUTER_STACK_SIZE, router_task, NULL, NULL, NULL, ROUTER_PRIO, 0,
		K_TICKS_FOREVER);
K_THREAD_DEFINE(server_id, SERVER_STACK_SIZE, server_task, NULL, NULL, NULL, SERVER_PRIO, 0,
		K_TICKS_FOREVER);

static void router_start(void)
{
	k_thread_start(router_id);
}

static void server_start(void)
{
	k_thread_start(server_id);
}

extern csp_conf_t csp_conf;

static void csp_get_syshk(csp_conn_t *conn, csp_packet_t *packet)
{
	enum adcs_obc_tlm_type type = packet->data[0];

	switch (type) {
	case TEMP:
		send_syshk(type, &temp_ret_fifo[syshk_tail], sizeof(struct adcs_temp_test_result),
			   conn);
		break;
	case CURRENT_VOLTAGE:
		send_syshk(type, &cv_ret_fifo[syshk_tail], sizeof(struct adcs_cv_test_result),
			   conn);
		break;
	case IMU:
		send_syshk(type, &imu_ret_fifo[syshk_tail], sizeof(struct imu_test_result), conn);
		break;
	case GNSS_HWMON:
		send_syshk(type, &gnss_hwmon_ret_fifo[syshk_tail], sizeof(struct gnss_hwmon_result),
			   conn);
		break;
	case GNSS_BESTPOS:
		send_syshk(type, &gnss_bestpos_ret_fifo[syshk_tail],
			   sizeof(struct gnss_bestpos_result), conn);
		break;
	case RW:
		send_syshk(type, &rw_data_fifo[syshk_tail], sizeof(struct rw_count_data), conn);
		break;
	case ALL_TEST_RESULT:
		send_syshk(type, &test_ret_fifo[syshk_tail], sizeof(struct all_test_result), conn);
		break;
	default:
		goto end;
	}

end:
	return;
}

void server(void)
{

	LOG_INF("Server task started");

	csp_socket_t sock = {0};

	csp_bind(&sock, CSP_ANY);

	csp_listen(&sock, 10);

	while (true) {

		csp_conn_t *conn;
		if ((conn = csp_accept(&sock, 10000)) == NULL) {
			continue;
		}

		csp_packet_t *packet;
		while ((packet = csp_read(conn, 50)) != NULL) {
			switch (csp_conn_dport(conn)) {
			case CSP_GET_SYSHK_PORT:
				csp_get_syshk(conn, packet);
				csp_buffer_free(packet);
				break;
			case CSP_SHELL_CMD_PORT:
				shell_execute_cmd(shell_backend_uart_get_ptr(), packet->data);
				csp_buffer_free(packet);
				break;
			default:
				csp_service_handler(packet);
				break;
			}
		}

		csp_close(conn);
	}

	return;
}

int csp_enable(void)
{
	int ret;
	const char *ifname = "CAN2";
	const struct device *can2 = DEVICE_DT_GET(DT_NODELABEL(can0));
	uint32_t bitrate = 1000000;
	uint16_t filter_addr = CSP_ID_ADCS;
	uint16_t filter_mask = 0x1F;

	LOG_INF("Initialising CSP");

	csp_conf.version = 1;

	csp_init();

	ret = csp_can_open_and_add_interface(can2, ifname, CSP_ID_ADCS, bitrate, filter_addr,
					     filter_mask, &can_iface);
	if (ret != CSP_ERR_NONE) {
		LOG_ERR("failed to add CAN interface [%s], error: %d\n", ifname, ret);
		goto end;
	}
	can_iface->is_default = 1;

	LOG_INF("Connection table");
	csp_conn_print_table();

	LOG_INF("Interfaces");
	csp_iflist_print();

	router_start();

	server_start();
end:
	return ret;
}

void csp_disable(void)
{
	csp_can_stop(can_iface);
}
```

## src/csp.h
```c
/*
 * Copyright (c) 2023 Space Cubics, LLC.
 *
 * SPDX-License-Identifier: Apache-2.0
 */

#pragma once

int csp_enable(void);
int csp_disable(void);
```

## src/cv.c
```c
/*
 * Copyright (c) 2023 Space Cubics, LLC.
 *
 * SPDX-License-Identifier: Apache-2.0
 */

#include <zephyr/drivers/i2c.h>
#include "cv.h"

#include <zephyr/logging/log.h>
LOG_MODULE_REGISTER(cv, CONFIG_SCSAT1_ADCS_LOG_LEVEL);

#define CV_ADCS_ADDR (0x42)
#define CV_RW_ADDR   (0x40)

#define CV_CH1_SHUNT_REG (0x01)
#define CV_CH1_BUS_REG   (0x02)
#define CV_CH2_SHUNT_REG (0x03)
#define CV_CH2_BUS_REG   (0x04)
#define CV_CH3_SHUNT_REG (0x05)
#define CV_CH3_BUS_REG   (0x06)
#define CV_RW_SHUNT_REG  (0x04)
#define CV_RW_BUS_REG    (0x05)

static const struct device *get_adcs_cv_device(enum adcs_cv_pos pos)
{
	const struct device *i2c0 = DEVICE_DT_GET(DT_NODELABEL(i2c0));

	switch (pos) {
	case ADCS_VDD_3V3_IMU_SHUNT:
	case ADCS_VDD_3V3_IMU_BUS:
	case ADCS_VDD_3V3_GPS_SHUNT:
	case ADCS_VDD_3V3_GPS_BUS:
	case ADCS_VDD_3V3_DRV_SHUNT:
	case ADCS_VDD_3V3_DRV_BUS:
		if (device_is_ready(i2c0)) {
			return i2c0;
		}
		break;
	default:
		break;
	}

	return NULL;
}

static const struct device *get_rw_cv_device(enum rw_cv_pos pos)
{
	const struct device *i2c1 = DEVICE_DT_GET(DT_NODELABEL(i2c1));
	const struct device *i2c2 = DEVICE_DT_GET(DT_NODELABEL(i2c2));
	const struct device *i2c3 = DEVICE_DT_GET(DT_NODELABEL(i2c3));

	switch (pos) {
	case ADCS_VDD_12V_DRVX_SHUNT:
	case ADCS_VDD_12V_DRVX_BUS:
		if (device_is_ready(i2c1)) {
			return i2c1;
		}
		break;
	case ADCS_VDD_12V_DRVY_SHUNT:
	case ADCS_VDD_12V_DRVY_BUS:
		if (device_is_ready(i2c2)) {
			return i2c2;
		}
		break;
	case ADCS_VDD_12V_DRVZ_SHUNT:
	case ADCS_VDD_12V_DRVZ_BUS:
		if (device_is_ready(i2c3)) {
			return i2c3;
		}
		break;
	default:
		break;
	}

	return NULL;
}

static int get_adcs_register_addr(enum adcs_cv_pos pos, uint16_t *addr)
{
	int ret = 0;

	switch (pos) {
	case ADCS_VDD_3V3_IMU_SHUNT:
		*addr = CV_CH1_SHUNT_REG;
		break;
	case ADCS_VDD_3V3_IMU_BUS:
		*addr = CV_CH1_BUS_REG;
		break;
	case ADCS_VDD_3V3_GPS_SHUNT:
		*addr = CV_CH2_SHUNT_REG;
		break;
	case ADCS_VDD_3V3_GPS_BUS:
		*addr = CV_CH2_BUS_REG;
		break;
	case ADCS_VDD_3V3_DRV_SHUNT:
		*addr = CV_CH3_SHUNT_REG;
		break;
	case ADCS_VDD_3V3_DRV_BUS:
		*addr = CV_CH3_BUS_REG;
		break;
	default:
		ret = -ENODEV;
		break;
	}

	return ret;
}

static int get_rw_register_addr(enum adcs_cv_pos pos, uint16_t *addr)
{
	int ret = 0;

	switch (pos) {
	case ADCS_VDD_12V_DRVX_SHUNT:
	case ADCS_VDD_12V_DRVY_SHUNT:
	case ADCS_VDD_12V_DRVZ_SHUNT:
		*addr = CV_RW_SHUNT_REG;
		break;
	case ADCS_VDD_12V_DRVX_BUS:
	case ADCS_VDD_12V_DRVY_BUS:
	case ADCS_VDD_12V_DRVZ_BUS:
		*addr = CV_RW_BUS_REG;
		break;
	default:
		ret = -ENODEV;
		break;
	}

	return ret;
}

static int32_t convert_cv_shunt(int16_t raw)
{
	return ((raw >> 3) * 40);
}

static int32_t convert_cv_bus(int16_t raw)
{
	return ((raw >> 3) * 8);
}

static float convert_rw_cv_shunt(int16_t raw)
{
	return (float)((raw * 5) / 1000);
}

static float convert_rw_cv_bus(uint16_t raw)
{
	return (raw * 3.125) / 1000;
}

static int convert_cv(enum adcs_cv_pos pos, int16_t raw, int32_t *cv)
{
	int ret = 0;

	switch (pos) {
	case ADCS_VDD_3V3_IMU_SHUNT:
	case ADCS_VDD_3V3_GPS_SHUNT:
	case ADCS_VDD_3V3_DRV_SHUNT:
		*cv = convert_cv_shunt(raw);
		break;
	case ADCS_VDD_3V3_IMU_BUS:
	case ADCS_VDD_3V3_GPS_BUS:
	case ADCS_VDD_3V3_DRV_BUS:
		*cv = convert_cv_bus(raw);
		break;
	default:
		ret = -ENODEV;
		break;
	}

	return ret;
}

static int convert_rw_cv(enum rw_cv_pos pos, uint16_t raw, float *cv)
{
	int ret = 0;

	switch (pos) {
	case ADCS_VDD_12V_DRVX_SHUNT:
	case ADCS_VDD_12V_DRVY_SHUNT:
	case ADCS_VDD_12V_DRVZ_SHUNT:
		*cv = convert_rw_cv_shunt((int16_t)raw);
		break;
	case ADCS_VDD_12V_DRVX_BUS:
	case ADCS_VDD_12V_DRVY_BUS:
	case ADCS_VDD_12V_DRVZ_BUS:
		*cv = convert_rw_cv_bus(raw);
		break;
	default:
		ret = -ENODEV;
		break;
	}

	return ret;
}

int get_adcs_cv(enum adcs_cv_pos pos, uint32_t *cv)
{
	int ret;
	uint8_t data[2];
	uint16_t reg;
	int16_t raw;

	const struct device *dev = get_adcs_cv_device(pos);
	if (dev == NULL) {
		LOG_ERR("I2C device is not ready. (pos: %d)", pos);
		ret = -ENODEV;
		goto end;
	}

	ret = get_adcs_register_addr(pos, &reg);
	if (ret < 0) {
		goto end;
	}

	ret = i2c_burst_read(dev, CV_ADCS_ADDR, reg, data, ARRAY_SIZE(data));
	if (ret < 0) {
		LOG_ERR("Failed to i2c_burst_read for Current/Voltage Monitor (pos: %d) (%d)", pos,
			ret);
		goto end;
	}
	raw = data[0] << 8 | data[1];

	ret = convert_cv(pos, raw, cv);
end:
	return ret;
}

int get_rw_cv(enum rw_cv_pos pos, float *cv)
{
	int ret;
	uint8_t data[2];
	uint16_t reg;
	uint16_t raw;

	const struct device *dev = get_rw_cv_device(pos);
	if (dev == NULL) {
		LOG_ERR("I2C device is not ready. (pos: %d)", pos);
		ret = -ENODEV;
		goto end;
	}

	ret = get_rw_register_addr(pos, &reg);
	if (ret < 0) {
		goto end;
	}

	ret = i2c_burst_read(dev, CV_RW_ADDR, reg, data, ARRAY_SIZE(data));
	if (ret < 0) {
		LOG_ERR("Failed to i2c_burst_read for RW Current/Voltage Monitor (pos: %d) (%d)",
			pos, ret);
		goto end;
	}
	raw = (data[0] << 8) | data[1];

	ret = convert_rw_cv(pos, raw, cv);
end:
	return ret;
}
```

## src/cv.h
```c
/*
 * Copyright (c) 2023 Space Cubics, LLC.
 *
 * SPDX-License-Identifier: Apache-2.0
 */

#pragma once

#include <stdint.h>

enum adcs_cv_pos {
	ADCS_VDD_3V3_IMU_SHUNT,
	ADCS_VDD_3V3_IMU_BUS,
	ADCS_VDD_3V3_GPS_SHUNT,
	ADCS_VDD_3V3_GPS_BUS,
	ADCS_VDD_3V3_DRV_SHUNT,
	ADCS_VDD_3V3_DRV_BUS,
};

enum rw_cv_pos {
	ADCS_VDD_12V_DRVX_SHUNT,
	ADCS_VDD_12V_DRVX_BUS,
	ADCS_VDD_12V_DRVY_SHUNT,
	ADCS_VDD_12V_DRVY_BUS,
	ADCS_VDD_12V_DRVZ_SHUNT,
	ADCS_VDD_12V_DRVZ_BUS,
};

int get_adcs_cv(enum adcs_cv_pos pos, uint32_t *cv);
int get_rw_cv(enum rw_cv_pos pos, float *cv);
```

## src/cv_test.c
```c
/*
 * Copyright (c) 2023 Space Cubics, LLC.
 *
 * SPDX-License-Identifier: Apache-2.0
 */

#include <zephyr/kernel.h>
#include "common.h"
#include "cv_adcs.h"
#include "cv_test.h"
#include "sc_fpgamon.h"

#include <zephyr/logging/log.h>
LOG_MODULE_REGISTER(cv_test, CONFIG_SCSAT1_ADCS_LOG_LEVEL);

#define CV_INVALID_FLOAT (0.0f)
#define CV_INVALID_UINT  (0U)

static int cv_obc_test(struct adcs_cv_test_result *cv_ret, uint32_t *err_cnt, bool log)
{
	int ret;
	int all_ret = 0;
	int32_t cv;
	enum obc_cv_pos obc_pos_list[] = {
		OBC_1V0_SHUNT,      OBC_1V0_BUS,      OBC_1V8_SHUNT,      OBC_1V8_BUS,
		OBC_3V3_SHUNT,      OBC_3V3_BUS,      OBC_3V3_SYSA_SHUNT, OBC_3V3_SYSA_BUS,
		OBC_3V3_SYSB_SHUNT, OBC_3V3_SYSB_BUS, OBC_3V3_IO_SHUNT,   OBC_3V3_IO_BUS,
	};
	const char obc_pos_name[][32] = {
		"OBC_1V0 Shunt",      "OBC_1V0 Bus",      "OBC_1V8 Shunt",      "OBC_1V8 Bus",
		"OBC_3V3 Shunt",      "OBC_3V3 Bus",      "OBC_3V3_SYSA Shunt", "OBC_3V3_SYSA Bus",
		"OBC_3V3_SYSB Shunt", "OBC_3V3_SYSB Bus", "OBC_3V3_IO Shunt",   "OBC_3V3_IO Bus",
	};
	const char obc_unit_name[][5] = {
		"[uv]", "[mv]", "[uv]", "[mv]", "[uv]", "[mv]",
		"[uv]", "[mv]", "[uv]", "[mv]", "[uv]", "[mv]",
	};

	for (int i = 0; i < ARRAY_SIZE(obc_pos_list); i++) {
		ret = sc_bhm_get_obc_cv(obc_pos_list[i], &cv);
		if (ret < 0) {
			cv_ret->obc_cv[i].data = CV_INVALID_UINT;
			HWTEST_LOG_ERR(log, "%s: Failed", obc_pos_name[i]);
			(*err_cnt)++;
			all_ret = -1;
		} else {
			cv_ret->obc_cv[i].data = cv;
			HWTEST_LOG_INF(log, "%s: %d %s", obc_pos_name[i], cv, obc_unit_name[i]);
		}
		cv_ret->obc_cv[i].status = ret;
	}

	return all_ret;
}

static int cv_xadc_test(struct adcs_cv_test_result *cv_ret, uint32_t *err_cnt, bool log)
{
	int ret;
	int all_ret = 0;
	float cv;
	enum xadc_cv_pos xadc_pos_list[] = {
		OBC_XADC_VCCINT,
		OBC_XADC_VCCAUX,
		OBC_XADC_VCCBRAM,
	};
	const char xadc_pos_name[][32] = {
		"OBC_XADC VCCINT",
		"OBC_XADC VCCAUX",
		"OBC_XADC VCCBRAM",
	};

	for (int i = 0; i < ARRAY_SIZE(xadc_pos_list); i++) {
		ret = sc_bhm_get_xadc_cv(xadc_pos_list[i], &cv);
		if (ret < 0) {
			cv_ret->xadc_cv[i].data = CV_INVALID_FLOAT;
			HWTEST_LOG_ERR(log, "%s: Failed", xadc_pos_name[i]);
			(*err_cnt)++;
			all_ret = -1;
		} else {
			cv_ret->xadc_cv[i].data = cv;
			HWTEST_LOG_INF(log, "%s: %.4f [v]", xadc_pos_name[i], (double)cv);
		}
		cv_ret->xadc_cv[i].status = ret;
	}

	return all_ret;
}

static int cv_adcs_test(struct adcs_cv_test_result *cv_ret, uint32_t *err_cnt, bool log)
{
	int ret;
	int all_ret = 0;
	int32_t cv;
	enum adcs_cv_pos adcs_pos_list[] = {
		ADCS_VDD_3V3_IMU_SHUNT, ADCS_VDD_3V3_IMU_BUS,   ADCS_VDD_3V3_GPS_SHUNT,
		ADCS_VDD_3V3_GPS_BUS,   ADCS_VDD_3V3_DRV_SHUNT, ADCS_VDD_3V3_DRV_BUS,
	};
	const char adcs_pos_name[][32] = {
		"ADCS_VDD_3V3_IMU Shunt", "ADCS_VDD_3V3_IMU Bus",   "ADCS_VDD_3V3_GPS Shunt",
		"ADCS_VDD_3V3_GPS Bus",   "ADCS_VDD_3V3_DRV Shunt", "ADCS_VDD_3V3_DRV Bus",
	};
	const char adcs_unit_name[][5] = {
		"[uv]", "[mv]", "[uv]", "[mv]", "[uv]", "[mv]",
	};

	for (int i = 0; i < ARRAY_SIZE(adcs_pos_list); i++) {
		ret = get_adcs_cv(adcs_pos_list[i], &cv);
		if (ret < 0) {
			cv_ret->adcs_cv[i].data = CV_INVALID_UINT;
			HWTEST_LOG_ERR(log, "%s: Failed", adcs_pos_name[i]);
			(*err_cnt)++;
			all_ret = -1;
		} else {
			cv_ret->adcs_cv[i].data = cv;
			HWTEST_LOG_INF(log, "%s: %d %s", adcs_pos_name[i], cv, adcs_unit_name[i]);
		}
		cv_ret->adcs_cv[i].status = ret;
	}

	return all_ret;
}

static int cv_rw_test(struct adcs_cv_test_result *cv_ret, uint32_t *err_cnt, bool log)
{
	int ret;
	int all_ret = 0;
	float cv;
	enum rw_cv_pos rw_pos_list[] = {
		ADCS_VDD_12V_DRVX_SHUNT, ADCS_VDD_12V_DRVX_BUS,   ADCS_VDD_12V_DRVY_SHUNT,
		ADCS_VDD_12V_DRVY_BUS,   ADCS_VDD_12V_DRVZ_SHUNT, ADCS_VDD_12V_DRVZ_BUS,
	};
	const char rw_pos_name[][32] = {
		"ADCS_VDD_12V_DRVX Shunt", "ADCS_VDD_12V_DRVX Bus",   "ADCS_VDD_12V_DRVY Shunt",
		"ADCS_VDD_12V_DRVY Bus",   "ADCS_VDD_12V_DRVZ Shunt", "ADCS_VDD_12V_DRVZ Bus",
	};
	const char rw_unit_name[][5] = {
		"[mv]", "[v]", "[mv]", "[v]", "[mv]", "[v]",
	};

	for (int i = 0; i < ARRAY_SIZE(rw_pos_list); i++) {
		ret = get_rw_cv(rw_pos_list[i], &cv);
		if (ret < 0) {
			cv_ret->rw_cv[i].data = CV_INVALID_FLOAT;
			HWTEST_LOG_ERR(log, "%s: Failed", rw_pos_name[i]);
			(*err_cnt)++;
			all_ret = -1;
		} else {
			cv_ret->rw_cv[i].data = cv;
			HWTEST_LOG_INF(log, "%s: %.4f %s", rw_pos_name[i], (double)cv,
				       rw_unit_name[i]);
		}
		cv_ret->rw_cv[i].status = ret;
	}

	return all_ret;
}

int cv_test(struct adcs_cv_test_result *cv_ret, uint32_t *err_cnt, bool log)
{
	int ret;
	int all_ret = 0;

	ret = cv_obc_test(cv_ret, err_cnt, log);
	if (ret < 0) {
		all_ret--;
	}

	ret = cv_xadc_test(cv_ret, err_cnt, log);
	if (ret < 0) {
		all_ret--;
	}

	ret = cv_adcs_test(cv_ret, err_cnt, log);
	if (ret < 0) {
		all_ret--;
	}

	ret = cv_rw_test(cv_ret, err_cnt, log);
	if (ret < 0) {
		all_ret--;
	}

	return all_ret;
}
```

## src/cv_test.h
```c
/*
 * Copyright (c) 2023 Space Cubics, LLC.
 *
 * SPDX-License-Identifier: Apache-2.0
 */

#pragma once

#include "syshk.h"

#define CV_OBC_POS_NUM  (12U)
#define CV_XADC_POS_NUM (3U)
#define CV_ADCS_POS_NUM (6U)
#define CV_RW_POS_NUM   (6U)

struct adcs_cv_test_result {
	struct syshk_u32_data obc_cv[CV_OBC_POS_NUM];
	struct syshk_float_data xadc_cv[CV_XADC_POS_NUM];
	struct syshk_u32_data adcs_cv[CV_ADCS_POS_NUM];
	struct syshk_u32_data rw_cv[CV_RW_POS_NUM];
};

int cv_test(struct adcs_cv_test_result *cv_ret, uint32_t *err_cnt, bool log);
```

## src/gnss.c
```c
/*
 * Copyright (c) 2023 Space Cubics, LLC.
 *
 * SPDX-License-Identifier: Apache-2.0
 */

#include <string.h>
#include <zephyr/kernel.h>
#include <zephyr/drivers/uart.h>
#include "gnss.h"

#include <zephyr/logging/log.h>
LOG_MODULE_REGISTER(gnss, CONFIG_SCSAT1_ADCS_LOG_LEVEL);

#define GNSS_WAKE_RETRY_COUNT  (200U)
#define GNSS_HWMON_RETRY_COUNT (2000U)
#define GNSS_PROMPT            "[COM1]"
#define GNSS_HWMON_ONCE_CMD    "log hwmonitora once\n"
#define GNSS_BESTPOS_ONCE_CMD  "log bestposa once\n"
#define GNSS_RESP_MAX_SIZE     (300U)
#define GNSS_HWMON_DATA_NUM    (24U)
#define GNSS_BESTPOS_DATA_NUM  (33U)

const struct device *gnss = DEVICE_DT_GET(DT_NODELABEL(gnss_uart));

static void gnss_fifo_clear(void)
{
	int ret;
	uint8_t c;

	while (true) {
		ret = uart_fifo_read(gnss, &c, 1);
		if (ret == 1) {
			continue;
		} else {
			break;
		}
	}
}

static int gnss_parse_hwmon_data(const char *gnss_str, struct gnss_hwmon_data *data)
{
	int ret;
	char ok[5];
	char com[20];
	char port[10];
	uint8_t item_num;
	uint16_t type[5];
	char last[20];

	ret = sscanf(
		gnss_str,
		"%5s %20[^,],%10[^,],%d,%f,%10[^,],%d,%f,%x,%x,%d;%hhu,%f,%hx,%f,%hx,%f,%hx,%f,%"
		"hx,%f,%hx,%f,%s",
		ok, com, port, &data->sequence, &data->idle_time, data->time_status, &data->week,
		&data->seconds, &data->receiver_status, &data->reserved, &data->receiver_version,
		&item_num, &data->temp, &type[0], &data->voltage_3v3, &type[1],
		&data->voltage_antenna, &type[2], &data->core_voltage_1v2, &type[3],
		&data->supply_voltage, &type[4], &data->voltage_1v8, last);

	LOG_DBG("OK: %s", ok);
	LOG_DBG("COM: %s", com);
	LOG_DBG("PORT: %s", port);
	LOG_DBG("SEQUENCE: %d", data->sequence);
	LOG_DBG("IDLE_TIME: %f", (double)data->idle_time);
	LOG_DBG("TIMESTATUS: %s", data->time_status);
	LOG_DBG("WEEK: %d", data->week);
	LOG_DBG("SECONDS: %f", (double)data->seconds);
	LOG_DBG("RECEIVER_STATUS: %d", data->receiver_status);
	LOG_DBG("RESERVED: %x", data->reserved);
	LOG_DBG("RECEIVER_VERSION: %d", data->receiver_version);
	LOG_DBG("TEMP: %f", (double)data->temp);
	LOG_DBG("3V3_VOLTAGE: %f", (double)data->voltage_3v3);
	LOG_DBG("ANTENNA_VOLTAGE: %f", (double)data->voltage_antenna);
	LOG_DBG("1V2_CORE_VOLTAGE: %f", (double)data->core_voltage_1v2);
	LOG_DBG("SUPPLY_VOLTAGE: %f", (double)data->supply_voltage);
	LOG_DBG("1V8_VOLTAGE: %f", (double)data->voltage_1v8);

	if (ret == GNSS_HWMON_DATA_NUM) {
		return 0;
	} else {
		return -1;
	}
}

static int gnss_parse_bestpos_data(const char *gnss_str, struct gnss_bestpos_data *data)
{
	int ret;
	char ok[5];
	char com[20];
	char port[10];
	char last[20];

	ret = sscanf(gnss_str,
		     "%5s %20[^,],%10[^,],%d,%f,%10[^,],%d,%f,%x,%x,%d;%24[^,],%24[^,],%f,%f,%f,%f,"
		     "%16[^,],%f,%f,%f,%12[^,],%f,%f,%hhu,%hhu,%hhu,%hhu,%hhx,%hhx,%hhx,%hhx*%s",
		     ok, com, port, &data->sequence, &data->idle_time, data->time_status,
		     &data->week, &data->seconds, &data->receiver_status, &data->reserved,
		     &data->receiver_version, data->sol_stat, data->pos_type, &data->lat_deg,
		     &data->lon_deg, &data->hgt_deg, &data->undulation, data->datum_id,
		     &data->lat_m, &data->lon_m, &data->hgt_m, data->stn_id, &data->diff_age,
		     &data->sol_age, &data->svs, &data->soln_svs, &data->soln1_svs,
		     &data->solnmulti_svs, &data->pos_reserved, &data->ext_sol_stat,
		     &data->galileo_mask, &data->gps_mask, last);

	LOG_DBG("OK: %s", ok);
	LOG_DBG("COM: %s", com);
	LOG_DBG("PORT: %s", port);
	LOG_DBG("SEQUENCE: %d", data->sequence);
	LOG_DBG("IDLE_TIME: %f", (double)data->idle_time);
	LOG_DBG("TIMESTATUS: %s", data->time_status);
	LOG_DBG("WEEK: %d", data->week);
	LOG_DBG("SECONDS: %f", (double)data->seconds);
	LOG_DBG("RECEIVER_STATUS: %d", data->receiver_status);
	LOG_DBG("RESERVED: %x", data->reserved);
	LOG_DBG("RECEIVER_VERSION: %d", data->receiver_version);
	LOG_DBG("SOL_STAT: %s", data->sol_stat);
	LOG_DBG("POS_TYPE: %s", data->pos_type);
	LOG_DBG("LAT_DEG: %f", (double)data->lat_deg);
	LOG_DBG("LON_DEG: %f", (double)data->lon_deg);
	LOG_DBG("HGT_DEG: %f", (double)data->hgt_deg);
	LOG_DBG("UNDULATION: %f", (double)data->undulation);
	LOG_DBG("DATUM_ID: %s", data->datum_id);
	LOG_DBG("LAT_M: %f", (double)data->lat_m);
	LOG_DBG("LON_M: %f", (double)data->lon_m);
	LOG_DBG("HGT_M: %f", (double)data->hgt_m);
	LOG_DBG("STN_ID: %s", data->stn_id);
	LOG_DBG("DIFF_AGE: %f", (double)data->diff_age);
	LOG_DBG("SOL_AGE: %f", (double)data->sol_age);
	LOG_DBG("SVS: %d", data->svs);
	LOG_DBG("SOLN_SVS: %d", data->soln_svs);
	LOG_DBG("SOLN1_SVS: %d", data->soln1_svs);
	LOG_DBG("SOLNMULTI_SVS: %d", data->solnmulti_svs);
	LOG_DBG("RESERVED: %d", data->pos_reserved);
	LOG_DBG("EXT_SOL_STAT: %02x", data->ext_sol_stat);
	LOG_DBG("GALILEO_MASK: %02x", data->galileo_mask);
	LOG_DBG("GPS_MASK: %02x", data->gps_mask);
	LOG_DBG("LAST: %s", last);

	if (ret == GNSS_BESTPOS_DATA_NUM) {
		return 0;
	} else {
		return -1;
	}

	return 0;
};

static int gnss_wait_uart_data(char *uart_data, bool log)
{
	int ret;
	int i;
	uint8_t c;
	uint16_t read_size = 0;
	uint8_t lf_count = 0;
	uint16_t usec_count = 0;
	uint16_t msec_count = 0;

	for (i = 0; i < GNSS_HWMON_RETRY_COUNT; i++) {
		if (read_size >= GNSS_RESP_MAX_SIZE) {
			break;
		} else if (lf_count == 3) {
			break;
		}

		ret = uart_fifo_read(gnss, &c, 1);
		if (ret < 0) {
			LOG_ERR("Failed to read the UART FIFO. (%d)", ret);
			break;
		} else if (ret == 1) {
			uart_data[read_size] = c;
			if (c == '\n') {
				lf_count++;
			}
			read_size++;
			usec_count++;
			k_sleep(K_USEC(20));
		} else {
			msec_count++;
			k_sleep(K_MSEC(1));
		}
	}

	if (i == GNSS_HWMON_RETRY_COUNT) {
		uart_data[read_size] = '\0';
		LOG_INF("%s", uart_data);
		LOG_ERR("GNSS data not received. read_size: %d", read_size);
		ret = -ETIMEDOUT;
	} else {
		uart_data[read_size] = '\0';
		if (log) {
			LOG_INF("%s", uart_data);
			LOG_INF("All GNSS data received: usec: %d, msec: %d", usec_count,
				msec_count);
		}
	}

	return ret;
}

int gnss_enable(void)
{
	int ret;
	int i;
	uint8_t prompt[strlen(GNSS_PROMPT) + 1];

	LOG_INF("Wait for wake up the GNSS about 10 seconds");
	for (i = 0; i < GNSS_WAKE_RETRY_COUNT; i++) {
		ret = uart_fifo_read(gnss, prompt, sizeof(prompt));
		if (ret == 0) {
			k_sleep(K_MSEC(100));
			continue;
		} else if (ret < 0) {
			LOG_ERR("Failed to read the UART FIFO. (%d)", ret);
			break;
		}
		prompt[strlen(GNSS_PROMPT)] = '\0';
		LOG_INF("GNSS has just awakened. %s", prompt);
		break;
	}

	if (i == GNSS_WAKE_RETRY_COUNT) {
		ret = -ETIMEDOUT;
	}

	return ret;
}

void gnss_disable(void)
{
}

int get_gnss_hwmon_data(struct gnss_hwmon_data *data, bool log)
{
	int ret;
	char uart_data[GNSS_RESP_MAX_SIZE];

	ret = uart_fifo_fill(gnss, GNSS_HWMON_ONCE_CMD, strlen(GNSS_HWMON_ONCE_CMD));
	if (ret < 0) {
		printk("Failed to fill the command strings to UART FIFO. %d\n", ret);
		goto end;
	}

	gnss_fifo_clear();

	ret = gnss_wait_uart_data(uart_data, log);
	if (ret < 0) {
		LOG_ERR("Failed to get the GNSS data. (%d)", ret);
		goto end;
	}

	ret = gnss_parse_hwmon_data(uart_data, data);
	if (ret < 0) {
		LOG_ERR("Failed to parse the GNSS data. (%d)", ret);
	}

end:
	return ret;
}

int get_gnss_bestpos_data(struct gnss_bestpos_data *data, bool log)
{
	int ret;
	char uart_data[GNSS_RESP_MAX_SIZE];

	ret = uart_fifo_fill(gnss, GNSS_BESTPOS_ONCE_CMD, strlen(GNSS_BESTPOS_ONCE_CMD));
	if (ret < 0) {
		printk("Failed to fill the command strings to UART FIFO. %d\n", ret);
		goto end;
	}

	gnss_fifo_clear();

	ret = gnss_wait_uart_data(uart_data, log);
	if (ret < 0) {
		LOG_ERR("Failed to get the GNSS data. (%d)", ret);
		goto end;
	}

	ret = gnss_parse_bestpos_data(uart_data, data);
	if (ret < 0) {
		LOG_ERR("Failed to parse the GNSS data. (%d)", ret);
	}

end:
	return ret;
}
```

## src/gnss.h
```c
/*
 * Copyright (c) 2023 Space Cubics, LLC.
 *
 * SPDX-License-Identifier: Apache-2.0
 */

#pragma once

int gnss_enable(void);
void gnss_disable(void);
int get_gnss_hwmon_data(void);
```

## src/gnss_test.c
```c
/*
 * Copyright (c) 2023 Space Cubics, LLC.
 *
 * SPDX-License-Identifier: Apache-2.0
 */

#include <stdint.h>
#include <string.h>
#include "gnss_test.h"

int gnss_test(struct gnss_hwmon_result *hwmon_ret, struct gnss_bestpos_result *pos_ret,
	      uint32_t *err_cnt, bool log)
{
	int ret;
	struct gnss_hwmon_data hwmon_data;
	struct gnss_bestpos_data pos_data;

	ret = get_gnss_hwmon_data(&hwmon_data, log);
	if (ret < 0) {
		memset(hwmon_ret, 0, sizeof(*hwmon_ret));
		(*err_cnt)++;
	} else {
		hwmon_ret->sequence = hwmon_data.sequence;
		hwmon_ret->idle_time = hwmon_data.idle_time;
		memcpy(hwmon_ret->time_status, hwmon_data.time_status,
		       sizeof(hwmon_ret->time_status));
		hwmon_ret->week = hwmon_data.week;
		hwmon_ret->seconds = hwmon_data.seconds;
		hwmon_ret->receiver_status = hwmon_data.receiver_status;
		hwmon_ret->reserved = hwmon_data.reserved;
		hwmon_ret->receiver_version = hwmon_data.receiver_version;
		hwmon_ret->temp = hwmon_data.temp;
		hwmon_ret->voltage_3v3 = hwmon_data.voltage_3v3;
		hwmon_ret->voltage_antenna = hwmon_data.voltage_antenna;
		hwmon_ret->core_voltage_1v2 = hwmon_data.core_voltage_1v2;
		hwmon_ret->supply_voltage = hwmon_data.supply_voltage;
		hwmon_ret->voltage_1v8 = hwmon_data.voltage_1v8;
	}
	hwmon_ret->status = ret;

	ret = get_gnss_bestpos_data(&pos_data, log);
	if (ret < 0) {
		memset(pos_ret, 0, sizeof(*pos_ret));
		(*err_cnt)++;
	} else {
		pos_ret->sequence = pos_data.sequence;
		pos_ret->idle_time = pos_data.idle_time;
		memcpy(pos_ret->time_status, pos_data.time_status, sizeof(pos_ret->time_status));
		pos_ret->week = pos_data.week;
		pos_ret->seconds = pos_data.seconds;
		pos_ret->receiver_status = pos_data.receiver_status;
		pos_ret->reserved = pos_data.reserved;
		pos_ret->receiver_version = pos_data.receiver_version;
		memcpy(pos_ret->sol_stat, pos_data.sol_stat, sizeof(pos_ret->sol_stat));
		memcpy(pos_ret->pos_type, pos_data.pos_type, sizeof(pos_ret->pos_type));
		pos_ret->lat_deg = pos_data.lat_deg;
		pos_ret->lon_deg = pos_data.lon_deg;
		pos_ret->hgt_deg = pos_data.hgt_deg;
		pos_ret->undulation = pos_data.undulation;
		memcpy(pos_ret->datum_id, pos_data.datum_id, sizeof(pos_ret->datum_id));
		pos_ret->lat_m = pos_data.lat_m;
		pos_ret->lon_m = pos_data.lon_m;
		pos_ret->hgt_m = pos_data.hgt_m;
		memcpy(pos_ret->stn_id, pos_data.stn_id, sizeof(pos_ret->stn_id));
		pos_ret->diff_age = pos_data.diff_age;
		pos_ret->sol_age = pos_data.sol_age;
		pos_ret->svs = pos_data.svs;
		pos_ret->soln_svs = pos_data.soln_svs;
		pos_ret->soln1_svs = pos_data.soln1_svs;
		pos_ret->solnmulti_svs = pos_data.solnmulti_svs;
		pos_ret->pos_reserved = pos_data.pos_reserved;
		pos_ret->ext_sol_stat = pos_data.ext_sol_stat;
		pos_ret->galileo_mask = pos_data.galileo_mask;
		pos_ret->gps_mask = pos_data.gps_mask;
	}
	pos_ret->status = ret;

	return ret;
}
```
