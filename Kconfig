## Kconfig
```kconfig
# Copyright (c) 2023 Space Cubics, LLC.
# SPDX-License-Identifier: Apache-2.0

rsource "drivers/can/Kconfig"
rsource "drivers/i2c/Kconfig"
rsource "drivers/spi/Kconfig"
rsource "drivers/pwm/Kconfig"
rsource "drivers/misc/Kconfig"
```

## boards/arm/scsat1_adcs/Kconfig.board
```kconfig
# SC-Sat1 ADCS Board configuration

# Copyright (c) 2023 Space Cubics, LLC.
# SPDX-License-Identifier: Apache-2.0

config BOARD_SCSAT1_ADCS
	bool "SC-Sat1 ADCS Board"
	depends on SOC_SERIES_ARM_DESIGNSTART
```

## boards/arm/scsat1_main/Kconfig.board
```kconfig
# SC-Sat1 MAIN Board configuration

# Copyright (c) 2023 Space Cubics, LLC.
# SPDX-License-Identifier: Apache-2.0

config BOARD_SCSAT1_MAIN
	bool "SC-Sat1 MAIN Board"
	depends on SOC_SERIES_ARM_DESIGNSTART
```

## boards/arm/scsat1_main/Kconfig.defconfig
```kconfig
# SC-Sat1 MAIN Board

# Copyright (c) 2023 Space Cubics,LLC
# SPDX-License-Identifier: Apache-2.0

if BOARD_SCSAT1_MAIN

config BOARD
	default "scsat1_main"

config CPU_CORTEX_M_HAS_SYSTICK
	default y

config CPU_HAS_ARM_MPU
	default y

config NUM_IRQS
	default 32

endif # BOARD_SCSAT1_MAIN
```

## boards/arm/scsat1_main/dts/bindings/sc,dstrx3.yaml
```yaml
# SPDX-License-Identifier: Apache-2.0

description: Space Cubics DSTRX-3 (S-band Transceiver)

compatible: "sc,dstrx3"

include: base.yaml

properties:
  reg:
    required: true
```

## boards/sc/scsat1_adcs/Kconfig.defconfig
```kconfig
# SC-Sat1 ADCS Board

# Copyright (c) 2023 Space Cubics,LLC
# SPDX-License-Identifier: Apache-2.0

if BOARD_SCSAT1_ADCS

config CPU_CORTEX_M_HAS_SYSTICK
	default y

config CPU_HAS_ARM_MPU
	default y

config NUM_IRQS
	default 32

endif # BOARD_SCSAT1_ADCS
```

## boards/sc/scsat1_adcs/Kconfig.scsat1_adcs
```kconfig
# Copyright (c) 2023 Space Cubics, LLC.
# SPDX-License-Identifier: Apache-2.0

config BOARD_SCSAT1_ADCS
	select SOC_DESIGNSTART_FPGA_CORTEX_M3
```

## boards/sc/scsat1_adcs/board.yml
```yaml
board:
  name: scsat1_adcs
  vendor: sc
  socs:
    - name: designstart_fpga_cortex_m3
```

## boards/sc/scsat1_adcs/dts/bindings/sc,fpgaconf.yaml
```yaml
# Copyright (c) 2024, Space Cubics, LLC.
# SPDX-License-Identifier: Apache-2.0

description: Space Cubics FPGA Configration Register

compatible: "sc,fpgaconf"

include: base.yaml

properties:
  reg:
    required: true
```

## boards/sc/scsat1_adcs/dts/bindings/sc,fpgamon.yaml
```yaml
# SPDX-License-Identifier: Apache-2.0

description: Space Cubics FPGA System Monitor Register

compatible: "sc,fpgamon"

include: base.yaml

properties:
  reg:
    required: true
```

## boards/sc/scsat1_adcs/dts/bindings/sc,fpgasys.yaml
```yaml
# SPDX-License-Identifier: Apache-2.0

description: Space Cubics FPGA System Register

compatible: "sc,fpgasys"

include: base.yaml

properties:
  reg:
    required: true
```

## boards/sc/scsat1_main/board.yml
```yaml
board:
  name: scsat1_main
  vendor: sc
  socs:
    - name: designstart_fpga_cortex_m3
```

## boards/sc/scsat1_main/dts/bindings/sc,dstrx3.yaml
```yaml
# SPDX-License-Identifier: Apache-2.0

description: Space Cubics DSTRX-3 (S-band Transceiver)

compatible: "sc,dstrx3"

include: base.yaml

properties:
  reg:
    required: true

  tx-power:
    type: int
    description: |
      Default TX power mode value for DSTRX-3.
      Range is 0 to 15. Details is defined in ICD.
    required: true

  bit-rate:
    type: int
    description: |
      Default bit rate value for DSTRX-3.
      Range is 0 to 3. Details is defined in ICD.
    required: true
```

## boards/sc/scsat1_main/dts/bindings/sc,fpgahrmem.yaml
```yaml
# SPDX-License-Identifier: Apache-2.0

description: Space Cubics FPGA HRMEM Control Register

compatible: "sc,fpgahrmem"

include: base.yaml

properties:
  reg:
    required: true
```

## drivers/can/Kconfig.sccan
```kconfig
# Space Cubics CAN configuration options

# Copyright (c) 2023 Space Cubics,LLC
# SPDX-License-Identifier: Apache-2.0

config CAN_SCCAN
	bool "Space Cubics CAN Driver"
	default y
	depends on DT_HAS_SC_CAN_ENABLED
	help
	  Enable Space Cubics CAN Driver.
```

## drivers/misc/Kconfig
```kconfig
# Copyright (c) 2024 Space Cubics, LLC.
# SPDX-License-Identifier: Apache-2.0

menu "Space Cubics Miscellaneous Drivers"

rsource "dstrx3/Kconfig"
rsource "fpga/Kconfig"

endmenu
```

## drivers/misc/dstrx3/Kconfig
```kconfig
# Copyright (c) 2024 Space Cubics, LLC.
# SPDX-License-Identifier: Apache-2.0

menuconfig SC_DSTRX3
	bool "Space Cubics DSTRX-3 (S-Band Transceiver) driver"
	default y
	depends on DT_HAS_SC_DSTRX3_ENABLED
	help
	  Enable Space Cubics DSTRX-3 (S-Band Transceiver) driver.

if SC_DSTRX3

config SC_DSTRX3_INIT_PRIORITY
	int "Init priority"
	default 50
	help
	  DSTRX-3 Device driver initialization priority.

module = SC_DSTRX3
module-str = Space Cubics DSTRX-3 (S-Band Transceiver) driver
source "subsys/logging/Kconfig.template.log_config"

endif
```

## drivers/misc/fpga/Kconfig
```kconfig
# Copyright (c) 2024 Space Cubics, LLC.
# SPDX-License-Identifier: Apache-2.0

rsource "Kconfig.conf"
rsource "Kconfig.sys"
rsource "Kconfig.mon"
rsource "Kconfig.hrmem"
```

## drivers/misc/fpga/Kconfig.hrmem
```kconfig
# Copyright (c) 2024 Space Cubics, LLC.
# SPDX-License-Identifier: Apache-2.0

menuconfig SC_FPGAHRMEM
	bool "Space Cubics FPGA HRMEM Control Register driver"
	default y
	depends on DT_HAS_SC_FPGAHRMEM_ENABLED
	help
	  Enable Space Cubics FPGA HRMEM Control Register driver.

if SC_FPGAHRMEM

config SC_FPGAHRMEM_INIT_PRIORITY
	int "Init priority"
	default 50
	help
	   FPGA HRMEM Control Register driver initialization priority.

module = SC_FPGAHRMEM
module-str = Space Cubics FPGA HRMEM Control Register driver
source "subsys/logging/Kconfig.template.log_config"

endif
```

## drivers/misc/fpga/Kconfig.mon
```kconfig
# Copyright (c) 2024 Space Cubics, LLC.
# SPDX-License-Identifier: Apache-2.0

menuconfig SC_FPGAMON
	bool "Space Cubics FPGA System Monitor Register driver"
	default y
	depends on DT_HAS_SC_FPGAMON_ENABLED
	help
	  Enable Space Cubics FPGA System Monitor Register driver.

if SC_FPGAMON

config SC_FPGAMON_INIT_PRIORITY
	int "Init priority"
	default 50
	help
	   FPGA System Monitor Register driver initialization priority.

module = SC_FPGAMON
module-str = Space Cubics FPGA System Monitor Register driver
source "subsys/logging/Kconfig.template.log_config"

endif
```

## drivers/misc/fpga/Kconfig.sys
```kconfig
# Copyright (c) 2024 Space Cubics, LLC.
# SPDX-License-Identifier: Apache-2.0

menuconfig SC_FPGASYS
	bool "Space Cubics FPGA System Register driver"
	default y
	depends on DT_HAS_SC_FPGASYS_ENABLED
	help
	  Enable Space Cubics FPGA System Register driver.

if SC_FPGASYS

config SC_FPGASYS_INIT_PRIORITY
	int "Init priority"
	default 50
	help
	   FPGA System Register driver initialization priority.

module = SC_FPGASYS
module-str = Space Cubics FPGA System Register driver
source "subsys/logging/Kconfig.template.log_config"

endif
```

## lib/Kconfig
```kconfig
# Copyright (c) 2024 Space Cubics, LLC.
# SPDX-License-Identifier: Apache-2.0

menu "Space Cubics Libraries"

rsource "core/Kconfig"
rsource "flash/Kconfig"
rsource "csp/Kconfig"
rsource "sunsens/Kconfig"
rsource "mgnm/Kconfig"
rsource "mtq/Kconfig"
rsource "gnss/Kconfig"
rsource "imu/Kconfig"

endmenu
```

## lib/core/Kconfig
```kconfig
# Copyright (c) 2024 Space Cubics, LLC.
# SPDX-License-Identifier: Apache-2.0

menuconfig SC_LIB_CORE
	bool "Space Cubics Core libraries"
	default y
	help
	  Enable Space Cubics Core libraries.

if SC_LIB_CORE

config SC_LIB_CORE_WDOG_KICK_INTERVAL_SEC
	int "Watchdog timer kicking interval (seconds)"
	default 60
	help
	  Watchdog timer kicking interval (seconds).

config SC_LIB_CORE_WDOG_THREAD_PRIORITY
	int "Watchdog timer kicking thread priority"
	default 0
	help
	  Watchdog timer kicking thread priority.

config SC_LIB_CORE_WDOG_THREAD_STACK_SIZE
	int "Watchdog timer kicking thread stack size"
	default 256
	help
	  Watchdog timer kicking thread stack size.

endif

if BOARD_SCSAT1_MAIN
rsource "Kconfig.main"
endif

if BOARD_SCSAT1_ADCS
rsource "Kconfig.adcs"
endif
```

## lib/core/Kconfig.adcs
```kconfig
# Copyright (c) 2024 Space Cubics, LLC.
# SPDX-License-Identifier: Apache-2.0

menuconfig SC_LIB_CORE_ADCS
	bool "Space Cubics Core libraries for ADCS Board"
	default y
	help
	  Enable Space Cubics Core libraries for ADCS Board.

if SC_LIB_CORE_ADCS

module = SC_LIB_CORE_ADCS
module-str = Space Cubics Core libraries for ADCS Board
source "subsys/logging/Kconfig.template.log_config"

endif
```

## lib/core/Kconfig.main
```kconfig
# Copyright (c) 2024 Space Cubics, LLC.
# SPDX-License-Identifier: Apache-2.0

menuconfig SC_LIB_CORE_MAIN
	bool "Space Cubics Core libraries for MAIN Board"
	default y
	help
	  Enable Space Cubics Core libraries for MAIN Board.

if SC_LIB_CORE_MAIN

module = SC_LIB_CORE_MAIN
module-str = Space Cubics Core libraries for MAIN Board
source "subsys/logging/Kconfig.template.log_config"

endif
```
