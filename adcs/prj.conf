## CMakeLists.txt
```
# SPDX-License-Identifier: Apache-2.0

cmake_minimum_required(VERSION 3.20.0)

set(BOARD scsat1_adcs)
set(BOARD_ROOT ${CMAKE_CURRENT_LIST_DIR}/..)

find_package(Zephyr REQUIRED HINTS $ENV{ZEPHYR_BASE})
project(scsat1-adcs)

zephyr_include_directories(src/cmd)
zephyr_include_directories(src/tlm)
zephyr_include_directories(src/mon)

target_sources(app PRIVATE src/main.c)
target_sources(app PRIVATE src/csp.c)
target_sources(app PRIVATE src/cmd/handler.c)
target_sources(app PRIVATE src/cmd/pwrctrl.c)
target_sources(app PRIVATE src/cmd/tlm.c)
target_sources(app PRIVATE src/cmd/imu_tlm.c)
target_sources(app PRIVATE src/tlm/syshk.c)
target_sources(app PRIVATE src/mon/monitor.c)
target_sources(app PRIVATE src/mon/temp.c)
target_sources(app PRIVATE src/mon/cv.c)
target_sources(app PRIVATE src/mon/system.c)
```

## Kconfig
```
mainmenu "SC-Sat1 ADCS Board"

menu "Application"

menu "Logging"

module = SCSAT1_ADCS
module-str = SC-Sat1 ADCS Board
source "subsys/logging/Kconfig.template.log_config"

endmenu

rsource "Kconfig.thread"
rsource "Kconfig.syshk"
rsource "Kconfig.mon"

endmenu

menu "Zephyr"
source "Kconfig.zephyr"
endmenu
```

## Kconfig.mon
```
menu "Monitoring"

config SCSAT1_ADCS_MON_SYSTEM_INTERVAL_MSEC
	int "Monitor interval for System information (msec)"
	default 1000
	help
	  Monitor interval for System Information (sec).

config SCSAT1_ADCS_MON_TEMP_INTERVAL_MSEC
	int "Monitor interval for Temperature (msec)"
	default 5000
	help
	  Monitor interval for Temperature (sec).

config SCSAT1_ADCS_MON_CV_INTERVAL_MSEC
	int "Monitor interval for CV (msec)"
	default 5000
	help
	  Monitor interval for CV (sec).

config SCSAT1_ADCS_MON_SYSTEM_DELAY_MSEC
	int "Delay time before starting the monitoring (msec)."
	default 500
	help
	  Delay time before starting the initial monitoring (msec).

config SCSAT1_ADCS_MON_TEMP_DELAY_MSEC
	int "Delay time before starting the monitoring (msec)."
	default 1500
	help
	  Delay time before starting the initial monitoring (msec).

config SCSAT1_ADCS_MON_CV_DELAY_MSEC
	int "Delay time before starting the monitoring (msec)."
	default 2500
	help
	  Delay time before starting the initial monitoring (msec).

endmenu
```

## Kconfig.syshk
```
menu "System HK"

config SCSAT1_ADCS_SYSHK_INHIBIT_PERIOD_SEC
	int "Inhibit period for not sending System HK after startup (sec)"
	default 600
	help
	  Inhibit period for not sending System HK after startup (sec).

config SCSAT1_ADCS_SYSHK_INTERVAL_SEC
	int "Interval for sending System HK (sec)"
	default 10
	help
	  Interval for sending System HK (sec).

config SCSAT1_ADCS_CSP_CONN_TIMEOUT_MSEC
	int "Timeout for CSP connect (msec)"
	default 500
	help
	  Timeout for CSP connect (msec).

config SCSAT1_ADCS_AUTO_SYSHK_DOWNLINK
	bool "Whether to automatically downlink System HK"
	default n
	help
	  Whether to automatically downlink System HK.

config SCSAT1_ADCS_SYSHK_SUB_QUEUE_SIZE
	int "The notification queue's size for System HK"
	default 2
	help
	  The notification queue's size for System HK.

config SCSAT1_ADCS_ZBUS_READ_TIMEOUT_MSEC
	int "Timeout for ZBUS reading from channel (msec)"
	default 10
	help
	  Timeout for ZBUS reading from channel (msec).

endmenu
```

## Kconfig.thread
```
menu "Thread"

config SCSAT1_ADCS_CSP_ROUTER_THREAD_PRIORITY
	int "CSP router thread priority"
	default 0
	help
	  CSP router thread priority.

config SCSAT1_ADCS_CSP_ROUTER_THREAD_STACK_SIZE
	int "CSP router thread stack size"
	default 256
	help
	  CSP router thread stack size.

config SCSAT1_ADCS_CSP_SERVER_THREAD_PRIORITY
	int "CSP server thread priority"
	default 0
	help
	  CSP server thread priority.

config SCSAT1_ADCS_CSP_SERVER_THREAD_STACK_SIZE
	int "CSP server thread stack size"
	default 2048
	help
	  CSP server thread stack size.

config SCSAT1_ADCS_SEND_SYSHK_THREAD_PRIORITY
	int "Send System HK thread priority"
	default 1
	help
	  Send System HK thread priority

config SCSAT1_ADCS_SEND_SYSHK_THREAD_STACK_SIZE
	int "Send System HK thread stack size"
	default 1024
	help
	  Send for System HK thread stack size.

config SCSAT1_ADCS_MONITOR_THREAD_PRIORITY
	int "Monitor thread priority"
	default 2
	help
	  Monitor thread priority

config SCSAT1_ADCS_MONITOR_THREAD_STACK_SIZE
	int "Monitor thread stack size"
	default 1024
	help
	  Monitor thread stack size.

endmenu
```

## prj.conf
```kconfig
CONFIG_PICOLIBC=y
CONFIG_CAN=y
CONFIG_I2C=y
CONFIG_SPI=y
CONFIG_SPI_EXTENDED_MODES=y
CONFIG_PWM=y
CONFIG_LOG=y
CONFIG_MAIN_STACK_SIZE=4096
CONFIG_CRC=y
# For CSP
CONFIG_LIBCSP=y
CONFIG_CSP_USE_RTABLE=n
CONFIG_EVENTS=y
CONFIG_HEAP_MEM_POOL_SIZE=2048
# For NOR flash
CONFIG_FLASH=y
CONFIG_SPI_NOR=y
CONFIG_FLASH_MAP=y
CONFIG_FLASH_MAP_LABELS=y
# For LittleFS
CONFIG_FILE_SYSTEM=y
CONFIG_FILE_SYSTEM_LITTLEFS=y
# For ZBUS
CONFIG_ZBUS=y
CONFIG_ZBUS_CHANNEL_NAME=y
CONFIG_ZBUS_OBSERVER_NAME=y
CONFIG_ZBUS_MSG_SUBSCRIBER=y
CONFIG_ZBUS_MSG_SUBSCRIBER_NET_BUF_POOL_SIZE=32
```

## app.overlay
```dts
#include <freq.h>
#include <mem.h>

/delete-node/ &uartlite0;

/ {
	soc {
		uartlite0: uartlite@4f010000 {
			compatible = "xlnx,xps-uartlite-1.00.a";
			interrupts = <0 0>;
			reg = <0x4f010000 0x10000>;
		};
	};
};
```

## src/main.c
```c
/*
 * Copyright (c) 2023 Space Cubics, LLC.
 *
 * SPDX-License-Identifier: Apache-2.0
 */

#include <zephyr/kernel.h>
#include "csp.h"
#include "wdog.h"
#include "config_nor.h"
#include "data_nor.h"
#include "fram.h"
#include "syshk.h"
#include "monitor.h"
#include "eps.h"

int main(void)
{
	start_kick_wdt_thread();

	datafs_init();
	sc_config_nor_set_addr_mode();

	sc_fram_update_boot_count();

	sc_csp_init();
	csp_time_sync_from_eps();

	start_monitor();

	start_send_syshk();

	while (true) {
		k_sleep(K_SECONDS(1));
	}

	return 0;
}
```

## src/csp.c
```c
/*
 * Copyright (c) 2024 Space Cubics, LLC.
 *
 * SPDX-License-Identifier: Apache-2.0
 */
#include <string.h>
#include <unistd.h>
#include <stdlib.h>
#include <csp/csp.h>
#include <csp/drivers/can_zephyr.h>
#include <zephyr/device.h>
#include "sc_csp.h"
#include "flash.h"
#include "file.h"
#include "upload.h"
#include "cmd/handler.h"

#include <zephyr/logging/log.h>
LOG_MODULE_REGISTER(csp, CONFIG_SCSAT1_ADCS_LOG_LEVEL);

static csp_iface_t *can_iface = NULL;

static void *router_task(void *param)
{
	while (true) {
		csp_route_work();
	}

	return NULL;
}

static void *server_task(void *p1, void *p2, void *p3)
{
	ARG_UNUSED(p1);
	ARG_UNUSED(p2);
	ARG_UNUSED(p3);

	csp_cmd_handler();

	return NULL; }

K_THREAD_DEFINE(router_id, CONFIG_SCSAT1_ADCS_CSP_ROUTER_THREAD_STACK_SIZE, router_task, NULL, NULL,
		NULL, CONFIG_SCSAT1_ADCS_CSP_ROUTER_THREAD_PRIORITY, 0, K_TICKS_FOREVER);
K_THREAD_DEFINE(server_id, CONFIG_SCSAT1_ADCS_CSP_SERVER_THREAD_STACK_SIZE, server_task, NULL, NULL,
		NULL, CONFIG_SCSAT1_ADCS_CSP_SERVER_THREAD_PRIORITY, 0, K_TICKS_FOREVER);

static void router_start(void)
{
	k_thread_start(router_id);
}

static void server_start(void)
{
	k_thread_start(server_id);
}

extern csp_conf_t csp_conf;

int sc_csp_init(void)
{
	int ret;
	const char *ifname = "CAN2";
	const struct device *can2 = DEVICE_DT_GET(DT_NODELABEL(can0));
	uint16_t filter_addr = CSP_ID_ADCS;
	uint16_t filter_mask = 0x1F;

	LOG_INF("Initialising CSP");

	csp_conf.version = 1;

	csp_init();

	ret = csp_can_open_and_add_interface(can2, ifname, CSP_ID_ADCS, CSP_CAN_BITRATE,
					     filter_addr, filter_mask, &can_iface);
	if (ret != CSP_ERR_NONE) {
		LOG_ERR("failed to add CAN interface [%s], error: %d\n", ifname, ret);
		goto end;
	}
	can_iface->is_default = 1;

	LOG_INF("Connection table");
	csp_conn_print_table();

	LOG_INF("Interfaces");
	csp_iflist_print();

	router_start();

	server_start();

	csp_flash_handler_init();
	csp_file_handler_init();
	csp_upload_handler_init();
end:
	return ret;
}
```

## src/csp.h
```c
/*
 * Copyright (c) 2024 Space Cubics, LLC.
 *
 * SPDX-License-Identifier: Apache-2.0
 */

#pragma once

int sc_csp_init(void);
```

## src/version.h
```c
/*
 * Copyright (c) 2024 Space Cubics, LLC.
 *
 * SPDX-License-Identifier: Apache-2.0
 */

#pragma once

#define ADCS_FSW_VERSION "1.0.1"
```
